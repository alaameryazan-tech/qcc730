## Kconfig
```kconfig
mainmenu "Fermion Kconfig"

source "boards/Kconfig"
source "soc/Kconfig"
source "lib/Kconfig"
source "modules/Kconfig"
```

## boards/Kconfig
```kconfig
config QCCSDK_BOARD_NAME
	string "qccsdk board name"
	default "$(QCCSDK_BOARD_NAME)"

#$(info, QCCSDK_BOARD_NAME $(QCCSDK_BOARD_NAME))
rsource "$(QCCSDK_BOARD_NAME)/Kconfig.board"
```

## boards/cqm730i/Kconfig.board
```kconfig
config BOARD_CQM730I
	bool "BOARD CQM730I as QCC730V2 MP board on iPA"
	select SOC_QCC730V2
	default n
```

## boards/cqm730i/cqm730i_defconfig
```kconfig
#BOARD CQM730I as QCC730V2 MP board on iPA
CONFIG_BOARD_CQM730I=y

CONFIG_BOARD_QCC730_I2C_ENABLE=y

CONFIG_BOARD_QCC730_QSPI_ENABLE=y
CONFIG_BOARD_QCC730_QSPI_V2_QUAD_MODE=1

CONFIG_BOARD_QCC730_UART_ENABLE=y
CONFIG_BOARD_QCC730_UART_GPIO_OPTION=1

#CONFIG_BOARD_QCC730_XPA_AUTO_CTRL_ENABLE=y
#CONFIG_BOARD_QCC730_XPA_AUTO_CTRL_GPIO_OPTION=0

CONFIG_PBL_PREES_RESET_FOR_DTIM=y
```

## boards/cqm730x/Kconfig.board
```kconfig
config BOARD_CQM730X
	bool "BOARD CQM730X as QCC730V2 MP board on xPA"
	select SOC_QCC730V2
	default n
```

## boards/mqm405i/Kconfig.board
```kconfig
config BOARD_MQM405I
	bool "BOARD MQM405I as QCC730V2 MP board on iPA"
	select SOC_QCC730V2
	default n
```

## boards/mqm405x/Kconfig.board
```kconfig
config BOARD_MQM405X
	bool "BOARD MQM405X as QCC730V2 MP board on xPA"
	select SOC_QCC730V2
	default n
```

## boards/mqm730i/Kconfig.board
```kconfig
config BOARD_MQM730I
	bool "BOARD MQM730I as QCC730V2 MP board on iPA"
	select SOC_QCC730V2
	default n
```

## boards/mqm730x/Kconfig.board
```kconfig
config BOARD_MQM730X
	bool "BOARD MQM730X as QCC730V2 MP board on xPA"
	select SOC_QCC730V2
	default n
```

## boards/qcc730v1_socket/Kconfig.board
```kconfig
config BOARD_QCC730V1_SOCKET
	bool "BOARD QCC730V1 SOCKET"
	select SOC_QCC730V1
	default n
```

## boards/qcc730v1_socket/qcc730v1_socket_defconfig
```kconfig
CONFIG_BOARD_QCC730V1_SOCKET=y

CONFIG_BOARD_QCC730_I2C_ENABLE=y

CONFIG_BOARD_QCC730_QSPI_ENABLE=y
CONFIG_BOARD_QCC730_QSPI_V1_OPTION=0

CONFIG_BOARD_QCC730_UART_ENABLE=y

#CONFIG_BOARD_QCC730_SPI_SLAVE_ENABLE=y
#CONFIG_BOARD_QCC730_SPI_SLAVE_OPTION=1
```

## boards/qcc730v2_evb11_hostless/Kconfig.board
```kconfig
config BOARD_QCC730V2_EVB11_HOSTLESS
	bool "BOARD QCC730V2 EVB v1.1 HOSTLESS for xPA"
	select SOC_QCC730V2
	default n
```

## boards/qcc730v2_evb11_hostless/qcc730v2_evb11_hostless_defconfig
```kconfig
#BOARD QCC730V2 EVB v1.1 HOSTLESS for xPA
CONFIG_BOARD_QCC730V2_EVB11_HOSTLESS=y

CONFIG_BOARD_QCC730_I2C_ENABLE=y

CONFIG_BOARD_QCC730_QSPI_ENABLE=y
CONFIG_BOARD_QCC730_QSPI_V2_QUAD_MODE=1

CONFIG_BOARD_QCC730_UART_ENABLE=y
CONFIG_BOARD_QCC730_UART_GPIO_OPTION=3

#CONFIG_BOARD_QCC730_XPA_AUTO_CTRL_ENABLE=y
#CONFIG_BOARD_QCC730_XPA_AUTO_CTRL_GPIO_OPTION=0

CONFIG_PBL_PREES_RESET_FOR_DTIM=y
```

## boards/qcc730v2_evb12_hostless/Kconfig.board
```kconfig
config BOARD_QCC730V2_EVB12_HOSTLESS
	bool "BOARD QCC730V2 EVB v1.2 hostless for iPA, temp version due to without Flash"
	select SOC_QCC730V2
	default n
```

## boards/qcc730v2_evb12_hostless/qcc730v2_evb12_hostless_defconfig
```kconfig
#BOARD QCC730V2 EVB v1.2 hostless for iPA, temp version due to without Flash
CONFIG_BOARD_QCC730V2_EVB12_HOSTLESS=y

CONFIG_BOARD_QCC730_I2C_ENABLE=y

CONFIG_BOARD_QCC730_UART_ENABLE=y
CONFIG_BOARD_QCC730_UART_GPIO_OPTION=0

#CONFIG_BOARD_QCC730_SPI_SLAVE_ENABLE=y
#CONFIG_BOARD_QCC730_SPI_SLAVE_OPTION=1

CONFIG_PBL_PREES_RESET_FOR_DTIM=y
```

## boards/qcc730v2_evb13_hostless/Kconfig.board
```kconfig
config BOARD_QCC730V2_EVB13_HOSTLESS
	bool "BOARD QCC730V2 EVB v1.3 HOSTLESS for iPA"
	select SOC_QCC730V2
	default n
```

## boards/qcc730v2_evb13_hostless/qcc730v2_evb13_hostless_defconfig
```kconfig
#BOARD QCC730V2 EVB v1.3 HOSTLESS for iPA
CONFIG_BOARD_QCC730V2_EVB13_HOSTLESS=y

CONFIG_BOARD_QCC730_I2C_ENABLE=y

CONFIG_BOARD_QCC730_QSPI_ENABLE=y
CONFIG_BOARD_QCC730_QSPI_V2_QUAD_MODE=1

CONFIG_BOARD_QCC730_UART_ENABLE=y
CONFIG_BOARD_QCC730_UART_GPIO_OPTION=3

CONFIG_PBL_PREES_RESET_FOR_DTIM=y
```

## boards/qcc730v2_socket/Kconfig.board
```kconfig
config BOARD_QCC730V2_SOCKET
	bool "BOARD QCC730V2 SOCKET"
	select SOC_QCC730V2
	default n
```

## lib/Kconfig
```kconfig
menu "lib setting"
config FREERTOS_PLUS_POSIX
    bool "enable FreeRTOS-Plus-POSIX"
    default n

config QCCSDK_DEMO
    bool "enable QCCSDK DEMO"
    default n
config FLASH_SHELL
    bool "enable flash shell"
    depends on BOARD_QCC730_QSPI_ENABLE
    default n
config WIFI_SHELL
    bool "enable wifi shell"
    default n
config WLAN_QAPI
    bool "enable WLAN QAPI"
    default n
config PLATFORM_SHELL
    bool "enable platform shell"
    default n
config LOWPOWER_SHELL
    bool "enable low power shell"
    default n
config I2CM_SHELL
    bool "enable i2c master shell"
    default n
config GPIO_SHELL
    bool "enable gpio shell"
config UART_QAPI
    bool "enable uart qapi"
    default n
config UART_SHELL
    bool "enable uart shell"
	select UART_QAPI
    default n
config NET_SHELL
    bool "enable net shell"
    default n
config PROF_SHELL
	bool "enable prof shell"
	default n
config PROF
    bool "enable PROF"
    default n
config PLATFORM_QAPI
    bool "enable platform qapi"
    default y
config QTIMER
    bool "enable QTIMER"
    default n

config UNITTEST_SHELL
    bool "enable unit_test commands"
    default n
    
config HEAP_STATISTIC
    bool "enable heap statistic"
    default n
config WMI_EVENT
    bool "enable wmi event"
    default y
config RING_IF
    bool "enable ring interface"
    default n
config SAP_POWERSAVE
    bool "enable powersave for sap"
    default n
config WFM_EN
    bool "enable WFM"
    default y
config DEBUG_STATS
    bool "enable DEBUG_STATS"
    default n
config DPM_STATS
    bool "enable DPM_STATS"
    default n
config RA_DEBUG
    bool "enable RA_DEBUG"
    default n
config WPS
    bool "enable WPS"
    default n
config P2P
    bool "enable P2P"
    default n
config COEX_MCI
    bool "enable COEX_MCI"
    default n
config COEX_PTA
    bool "enable COEX_PTA"
    default n
config 6G_BAND
    bool "enable 6G_BAND"
    default y
config LWIP_HEAP_POOL
    bool "enable LWIP_HEAP_POOL"
    default n
config LWIP_MULTIPLE_STREAMS
    bool "enable LWIP_MULTIPLE_STREAMS"
    default n
config FTM_MODE
    bool "enable FTM mode"
    default n

config DEBUG_CMD_XPA
    depends on BOARD_QCC730_XPA_AUTO_CTRL_ENABLE
    bool "config debug cmd xpa"
    default y

config CH12_CH13_DISABLE_XPA
    depends on BOARD_QCC730_XPA_AUTO_CTRL_ENABLE
    bool "config channel 12 13 to disable xpa"
    default n
    
config SIGMA_TRAFFIC
    bool "enable SIGMA_TRAFFIC"
    default n

config UNITTEST_SHELL
    bool "enable unit_test commands"
    default n
    
config 6GHZ
    bool "enable 6G support in qapi"
    default n

config MQTT_CLIENT
    bool "enable MQTT client"
    default n

config MQTT_CLIENT_DEMO
    depends on MQTT_CLIENT && FILE_SYSTEM
    bool "enable MQTT client demo"
    default n

config MQTT_PLAINTEXT_DEMO
    depends on MQTT_CLIENT && FILE_SYSTEM
    bool "enable MQTT over TCP demo"
    default n

config MQTT_BASIC_TLS_DEMO
    depends on MQTT_CLIENT && FILE_SYSTEM
    bool "enable MQTT over SSL one way authentication demo"
    default n

config MQTT_MUTUAL_AUTH_DEMO
    depends on MQTT_CLIENT && FILE_SYSTEM
    bool "enable MQTT over SSL mutual authentication demo"
    default n
config RNG_TEST
    bool "enable RNG test"
    default n

config NET_SSL_DEMO
    depends on NET_SHELL
    bool "enable ssl command under net shell"
    default y

config MATTER_ENABLE
    bool "MATTER function enable"
    default n
    help
        Enable Matter function

config GENERATE_MATTER_LIB
    depends on MATTER_ENABLE
    bool "Whether generate the Matter lib"
    default y

config SUPPORT_LWIP_RAW_SOCKET
    bool "If need to treat IPPROTO_RAW/NETCONN_RAW as a raw socket"
    default n

choice MATTER_DEMO_NAME
    prompt "Choose the Matter demo to build"
    depends on MATTER_ENABLE
    default MATTER_LIGHTING_DEMO

    config MATTER_LIGHTING_DEMO
        bool "Build Matter Lighting demo"

    config MATTER_SWITCH_DEMO
        bool "Build Matter Switch demo"
endchoice
endmenu
```

## modules/Kconfig
```kconfig
source "./modules/console/Kconfig"
source "./modules/fw_upgrade/Kconfig"
source "./modules/core/system/inc/Kconfig"
source "./modules/core/system/sys_src/Kconfig"
source "./modules/core/system/Kconfig"
source "./modules/fs/Kconfig"
source "./modules/net/mqtt_client/Kconfig"
source "./modules/net/httpc/Kconfig"
source "./modules/net/httpd/Kconfig"
source "./modules/net/mbedtls/Kconfig"
source "./modules/wifi/Kconfig"
source "./modules/net/sntp/Kconfig"
source "./modules/qat/Kconfig"
source "./modules/core/qcc_wifi/wps_stub/Kconfig"
source "./modules/supplicant/Kconfig"
```

## modules/console/Kconfig
```kconfig
menu "console setting"
config QCCSDK_CONSOLE
    bool "QCCSDK_CONSOLE enable"
    default n
    help
        enable QCCSDK Console
		
config RTT_VIEW_CLI
    bool "RTT_VIEW_CLI enable"
    default n
    help
        enable RTT VIEW CLI		
endmenu
```

## modules/core/system/inc/Kconfig
```kconfig
config PBL_PREES_GPIO_RESTORE
	bool "Restore GPIO to reset state, so to fix pre-ES PBL wrong operation on GPIO. If ioe_PBL released, please default to n"
	default y

config PBL_PREES_RESET_FOR_DTIM
	bool "A reset with CFG_FORCE_NPS_PD_ON is needed for Sleep function. If ioe_PBL released, please default to n"
	default n
```

## modules/core/system/sys_src/Kconfig
```kconfig
menu "System Setting"

config PBL_PREES_GPIO_RESTORE
	bool "Restore GPIO to reset state, so to fix pre-ES PBL wrong operation on GPIO. If ioe_PBL released, please default to n"
	default y

config PBL_PREES_RESET_FOR_DTIM
	bool "A reset with CFG_FORCE_NPS_PD_ON is needed for Sleep function. If ioe_PBL released, please default to n"
	default n

config RING_IF_ONLY
        bool "Enable RingIF for hosted mode. if hostless mode, please default to n"
        default n

config QCSPI_HFC_TEST 
        bool "Enable QCSPI Slave HFC test demo. if QCSPI HFC test demo is not needed , please default to n"
        default n

config QCSPI_HFC_ETH_ENABLE 
        bool "Enable QCSPI Slave HFC Viertual Ethernet interface. if QCSPI HFC ETH is not needed , please default to n"
        default n

config WATCH_DOG_ENABLE
	bool "Watch Dog function. Please default to n"
	default n

config WATCH_DOG_BITE_TIME
	int "When this timer timeout, it will trigger the reset, in unit of seconds.  Make sure to be bigger than bark timer."
	depends on WATCH_DOG_ENABLE
	default 8

config CPR_ENABLE
	bool "Core Power Reduction support, please default to y"
	default y

config QTMR_GRAY_CODING_WAR
	bool "A workaround to fix QTMR clock offset, please default to y"
	default y

config ULP_SMPS2_ONTSHOT_OPTIMIZE
	bool "Optimize ULP SMPS2 ontshot to support high temperature and low battery"
	default y

config PMU_TS_MON_PERIOD_US
	int "Temperature and VBAT are monitored interlavedly with this peroid us"
	default 1000000

config PRINTF_ERR
	bool "enalbe printf error message by err_printf"
	default y

config PRINTF_WARN
	bool "enalbe printf warning message by warn_printf"
	default y

config PRINTF_INFO
	bool "enalbe printf info message by info_printf"
	default y

config PRINTF_LOG
	bool "enalbe printf log message by log_printf"
	default n

config PRINTF_DUMP
	bool "enalbe printf dump message by dump_printf"
	default n

config ERROR_PREFIX
	string "prefix for err_printf"
	default "[ERR]"

config WARN_PREFIX
	string "prefix for warn_printf"
	default "[WARN]"

config INFO_PREFIX
	string "prefix for info_printf"
	default "[INFO]"

config LOG_PREFIX
	string "prefix for log_printf"
	default "[LOG]"

config DUMP_PREFIX
	string "prefix for dump_printf"
	default "[DUMP]"

config WIFI_FW_COREDUMP_SUPPORT
        bool "enable wifi firmware coredump support"
        default n

config WIFI_FW_RAMDUMP_PRINT_FLAG
        int "when this flag is set, the whole ram info should be printed"
        default 0

config BOARD_EVB_I2C_OPTION
        bool "when this flag is set n, the I2C eeprom should be for mqm"
        default n

rsource "mpu.Kconfig"

endmenu
```
