/*
 * Copyright (c) 2024 Qualcomm Innovation Center, Inc. All rights reserved.
 * SPDX-License-Identifier: BSD-3-Clause-Clear
*/

/*
 * Memory Spaces Definitions.
 */


MEMORY
{
  OTPMEM (rw) : ORIGIN = 0x001A0000, LENGTH = 0x00000220
  OTPRFMEM (rw) : ORIGIN = 0x001A0220, LENGTH = 0x00000DE0
  PBLMEM (xrw) : ORIGIN = 0x00200000, LENGTH = 0x00004000
  FDTMEM (rw) : ORIGIN = 0x00204000, LENGTH = 0x00000400
  SBLAMEM (xrw) : ORIGIN = 0x00204400, LENGTH = 0x00004000
  RESERVED (xrw) : ORIGIN = 0x00208400, LENGTH = 0x00002000
  PBL_PATCH (xrw) : ORIGIN = 0x0020A400, LENGTH = 0x00002000
  FSMEM (rw) : ORIGIN = 0x0020C400, LENGTH = 0x00008000
  CALMEM (rw) : ORIGIN = 0x00214400, LENGTH = 0x00003000
  BDFMEM (r) : ORIGIN = 0x00217400, LENGTH = 0x00006000
  REGDBMEM (r) : ORIGIN = 0x0021D400, LENGTH = 0x00004000
  INIMEM (r) : ORIGIN = 0x00221400, LENGTH = 0x00002000
  RRAMMEM (rw) : ORIGIN = 0x00223400, LENGTH = 0x0015CC00
  PBL_RAM (xrw) : ORIGIN = 0x00000000, LENGTH = 0x00008000
  SBL_RAM (xrw) : ORIGIN = 0x00008000, LENGTH = 0x00008000
  CONFIG_TABLE (rw) : ORIGIN = 0x00010000, LENGTH = 0x00010000
}
