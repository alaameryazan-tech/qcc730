## prj.conf
```kconfig
#
# matter_demo setting
#
CONFIG_QCCSDK_DEMO=y
CONFIG_QCCSDK_CONSOLE=y
CONFIG_FREERTOS_PLUS_POSIX=y

CONFIG_PLATFORM_SHELL=y
CONFIG_WIFI_SHELL=n
CONFIG_LOWPOWER_SHELL=y
CONFIG_NET_SHELL=y
CONFIG_WLAN_QAPI=y
CONFIG_LWIP_HEAP_POOL=y

CONFIG_WATCH_DOG_ENABLE=n
CONFIG_WATCH_DOG_BITE_TIME=8
CONFIG_FW_UPGRADE=y
CONFIG_MBEDTLS_USE_PKA=y
CONFIG_MBEDTLS_PKA_TEST=n
CONFIG_FILE_SYSTEM=y
CONFIG_FILE_SYSTEM_LITTLEFS=y
CONFIG_POSIX_FS_API=y
CONFIG_FS_SHELL=y

CONFIG_NET_SSL_DEMO=n
CONFIG_MATTER_ENABLE=y
CONFIG_GENERATE_MATTER_LIB=y
CONFIG_MATTER_SWITCH_DEMO=n
CONFIG_MPU_ENABLE=n
# end of qcli_demo setting
```

## src/matter_demo.c
```c
/*
 * Copyright (c) 2024 Qualcomm Innovation Center, Inc. All rights reserved.
 * SPDX-License-Identifier: BSD-3-Clause-Clear
 */

#include <stdlib.h>
#include "string.h"
#include "qapi_types.h"
#include "qapi_status.h"
#include "qcli.h"
#include "qcli_api.h"
#include "qcli_pal.h"
#include "qcli_util.h"

/**********************************************************************************************************/
/* Preprocessor Definitions and Constants											                      */
/**********************************************************************************************************/
#define MATTER_PRINTF_HANDLE qcli_matter_group

/**********************************************************************************************************/
/* Type Declarations											                                          */
/**********************************************************************************************************/

/**********************************************************************************************************/
/* Globals											                                                      */
/**********************************************************************************************************/
QAPI_Console_Group_Handle_t qcli_matter_group; /* Handle for our QCLI Command Group. */

/**********************************************************************************************************/
/* Function Declarations											                                      */
/**********************************************************************************************************/
static qapi_Status_t Command_Matter_Enable(uint32_t Parameter_Count, QAPI_Console_Parameter_t *Parameter_List);
static qapi_Status_t Command_Matter_Onboarding(uint32_t Parameter_Count, QAPI_Console_Parameter_t *Parameter_List);
static qapi_Status_t Command_Matter_Reset(uint32_t Parameter_Count, QAPI_Console_Parameter_t *Parameter_List);
#if CONFIG_MATTER_SWITCH_DEMO
static qapi_Status_t Command_Switch(uint32_t Parameter_Count, QAPI_Console_Parameter_t *Parameter_List);
#endif

/* The following is the complete command list for the Firmware Upgrade demo. */
const QAPI_Console_Command_t Matter_Command_List[] = {
    /* cmd_function                     cmd_string      usage_string              description */
    {Command_Matter_Enable, "enable", "\n\nenable", "Enable Matter Stack"},
    {Command_Matter_Onboarding, "onboarding", "\n\n<ssid> <password>",
     "Set ssid and pasword for on-network commission"},
    {Command_Matter_Reset, "reset", "\n\nreset", "Do factory reset"},
#if CONFIG_MATTER_SWITCH_DEMO
    {Command_Switch, "switch", "\n\nswitch [0 = unicast] [0 = off, 1 = on, 2 = toggle]", "Switch Command"},
#endif
};

const QAPI_Console_Command_Group_t Matter_Command_Group = {
    "Matter", /* Firmware Upgrade */
    sizeof(Matter_Command_List) / sizeof(QAPI_Console_Command_t),
    Matter_Command_List,
};

/**********************************************************************************************************/
/* Function Definitions    											                                      */
/**********************************************************************************************************/
/* This function is used to register the Firmware Upgrade Command Group with QCLI   */
void Initialize_Matter_Demo(void)
{
    /* Attempt to reqister the Command Groups with the qcli framework.*/
    MATTER_PRINTF_HANDLE = QAPI_Console_Register_Command_Group(NULL, &Matter_Command_Group);
    if (MATTER_PRINTF_HANDLE) {
        QCLI_Printf(MATTER_PRINTF_HANDLE, "Matter Registered \n");
    }
}

/*=================================================================================================*/

/**
   @brief This function processes the "enable" command from the CLI.
*/

void Matter_Enable();
void Matter_Onboarding(char *ssid, char *password);

void Matter_FactoryReset();
static qapi_Status_t Command_Matter_Enable(uint32_t Parameter_Count, QAPI_Console_Parameter_t *Parameter_List)
{
    (void)Parameter_Count;
    (void)Parameter_List;

    Matter_Enable();

    QCLI_Printf(MATTER_PRINTF_HANDLE, "Matter Enable \n");

    return QAPI_OK;
}

static qapi_Status_t Command_Matter_Onboarding(uint32_t Parameter_Count, QAPI_Console_Parameter_t *Parameter_List)
{
    if (Parameter_Count < 1 || !Parameter_List) {
        return QAPI_ERROR_CONSOLE_COMMAND_STATUS_USAGE;
    }

    char *ssid = Parameter_List[0].String_Value;

    if (Parameter_Count >= 2) {
        char *password = Parameter_List[1].String_Value;
        Matter_Onboarding(ssid, password);
    } else {
        Matter_Onboarding(ssid, "\0");
    }
    return QAPI_OK;
}

static qapi_Status_t Command_Matter_Reset(uint32_t Parameter_Count, QAPI_Console_Parameter_t *Parameter_List)
{
    (void)Parameter_Count;
    (void)Parameter_List;

    Matter_FactoryReset();

    QCLI_Printf(MATTER_PRINTF_HANDLE, "Matter Factory Reset \n");

    return QAPI_OK;
}

#if CONFIG_MATTER_SWITCH_DEMO
void OffSwitchCommandHandler();
void OnSwitchCommandHandler();
void ToggleSwitchCommandHandler();

static qapi_Status_t Command_Switch(uint32_t Parameter_Count, QAPI_Console_Parameter_t *Parameter_List)

{
    if ((Parameter_Count != 1) || (!Parameter_List[0].Integer_Is_Valid))
        return QAPI_ERROR_CONSOLE_COMMAND_STATUS_USAGE;

    // Unicast Command
    if (Parameter_List[0].Integer_Value == 0) {
        OffSwitchCommandHandler();
        return QAPI_OK;
    }

    if (Parameter_List[0].Integer_Value == 1) {
        OnSwitchCommandHandler();
        return QAPI_OK;
    }
    if (Parameter_List[0].Integer_Value == 2) {
        ToggleSwitchCommandHandler();
        return QAPI_OK;
    }

    return QAPI_ERROR;
}
#endif
```

## src/matter_demo.h
```c
/*
 * Copyright (c) 2024 Qualcomm Innovation Center, Inc. All rights reserved.
 * SPDX-License-Identifier: BSD-3-Clause-Clear
 */

void Initialize_Matter_Demo(void);
```

## src/matter_main.c
```c
/*
 * Copyright (c) 2024 Qualcomm Innovation Center, Inc. All rights reserved.
 * SPDX-License-Identifier: BSD-3-Clause-Clear
 */

#include <string.h>
#include <stdint.h>
#if CONFIG_MATTER_ENABLE
#include "matter_demo.h"
#endif

#ifdef FERMION_SILICON
extern uint32_t UART_Send_direct(char *txbuf, uint32_t buflen);
#define UART_SEND_DIRECT(str) UART_Send_direct((str), strlen(str))
#else
#define UART_SEND_DIRECT(str)
#endif

void __cpp_initialize__aeabi_(void);
void app_init(void)
{
    __cpp_initialize__aeabi_();
#if CONFIG_MATTER_ENABLE
    Initialize_Matter_Demo();
#endif
}

void app_main(void)
{
    UART_SEND_DIRECT("Matter demo running...\r\n");
}
```

## src/sbrk.c
```c
/*
 * Copyright (c) 2024 Qualcomm Innovation Center, Inc. All rights reserved.
 * SPDX-License-Identifier: BSD-3-Clause-Clear
 */

#include <stdint.h>
#include <stddef.h>
#include <stdio.h>

typedef void (*ctor_fn)(void);

extern ctor_fn __init_array_begin;
extern ctor_fn __init_array_end;

void __cpp_initialize__aeabi_(void)
{
    ctor_fn *ctors;

    /* The .init_array section is populated by both RealView and GCC as a list of
       function pointers. All that needs to be done is to go through the array in
       order, and call each function pointer. This needs to happen before any of
       the application code runs (i.e. main()). */
    for (ctors = &__init_array_begin; ctors != &__init_array_end; ctors++) {
        (*ctors)();
    }
}

/* Provides one of RealView's optimized versions of __cxa_vec_ctor that is used
   when no destructor is provided and no exceptions are being used. */
void *__aeabi_vec_ctor_nocookie_nodtor(void *user_array, void *(*constructor)(void *), size_t element_size,
                                       size_t element_count)
{
    size_t index;
    intptr_t obj;

    if (constructor != NULL) {
        obj = (intptr_t)user_array;

        for (index = 0; index < element_count; ++index) {
            (*constructor)((void *)obj);
            obj += element_size;
        }
    }

    /* AEABI specifies this must return its first argument. */
    return user_array;
}
```
