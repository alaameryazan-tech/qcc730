## prj.conf
```kconfig
# qcc730 demo setting

CONFIG_NET_SHELL=y

CONFIG_LOWPOWER_SHELL=y

CONFIG_PLATFORM_SHELL=y

CONFIG_QCCSDK_DEMO=y

CONFIG_WLAN_QAPI=y

#CONFIG_MQTT_CLIENT=y

#CONFIG_FILE_SYSTEM=y

#CONFIG_FILE_SYSTEM_LITTLEFS=y

#CONFIG_POSIX_FS_API=y

CONFIG_FW_UPGRADE=y

CONFIG_RING_IF_ONLY=n

CONFIG_QCCSDK_CONSOLE=y

CONFIG_WIFI_SHELL=y

CONFIG_FREERTOS_PLUS_POSIX=y

#CONFIG_QCSPI_HFC_TEST=y

# Transport layer mode of MQTT, Choose one of the following three modes

#CONFIG_MQTT_PLAINTEXT_DEMO=y

#CONFIG_MQTT_BASIC_TLS_DEMO=n

#CONFIG_MQTT_MUTUAL_AUTH_DEMO=n

# end of mqtt demo setting
```

## src/powertest_demo.h
```c
/*
 * Copyright (c) 2024 Qualcomm Innovation Center, Inc. All rights reserved.
 * SPDX-License-Identifier: BSD-3-Clause-Clear
 */

#include <string.h>
#include <stdint.h>
#include <stdbool.h>

/****************************************************************************
 * UART Write functions
 ***************************************************************************/
#ifdef FERMION_SILICON
extern uint32_t UART_Send_direct(char *txbuf, uint32_t buflen);
#define UART_SEND_DIRECT(str) UART_Send_direct((str), strlen(str))
#else
#define UART_SEND_DIRECT(str)
#endif

// UART LOG meesages
#define MAX_LOG_STR_LEN 255

#define LOG_INF(args...)                                                    \
    {                                                                       \
        char log_txt[MAX_LOG_STR_LEN] = "Demo: ";                           \
        const int8_t prefix_len = 5;                                        \
                                                                            \
        snprintf(log_txt + prefix_len, MAX_LOG_STR_LEN - prefix_len, args); \
        log_txt[MAX_LOG_STR_LEN - 1] = 0;                                   \
        UART_SEND_DIRECT(log_txt);                                          \
        UART_SEND_DIRECT("\n\r");                                           \
    }

void demo_app(void);

void demo_init(void);

/**
 * IP Ready event notifier
 */
void demo_wmi_ip_addr_ready_event();
```

## src/vcnl3020.c
```c
/*
 * Copyright (c) 2026 Qualcomm Innovation Center, Inc. All rights reserved.
 * SPDX-License-Identifier: BSD-3-Clause-Clear
 */

/* Vishay VCNL3020 IR proximity sensor - I2C, INTERRUPT-DRIVEN. See
 * vcnl3020.h for the calling contract and wiring notes.
 *
 * ROOT CAUSE OF THE EARLIER ~95ms INTERRUPT STORM (this file's own prior
 * version) - found by building an isolated standalone test (demo/
 * vcnl3020_test_demo, no WLAN/MQTT/DTIM at all) with the SAME sensor and
 * the SAME GPIO3 wiring, which came up completely clean: silent at idle,
 * exactly one STATUS transition per real touch/release, silent again with
 * /INT physically unplugged. Two things were different between that
 * working version and this file's prior one, and both are now fixed here:
 *
 *   1. THE ACTUAL CULPRIT: this file used to call vcnl3020_i2c_reopen()
 *      (qapi_I2CM_Close() + qapi_I2CM_Open()) before EVERY SINGLE register
 *      access - a workaround carried over from this SDK's SHT40 sensor
 *      code for a real, previously-observed issue (the I2C peripheral
 *      going stale after a long WLAN BMPS/DTIM10 idle period). Applied
 *      unconditionally on every interrupt-servicing pass, though, it
 *      means every GPIO3 edge - including a spurious one - immediately
 *      triggered an I2C peripheral close+reopen, which itself is a
 *      plausible source of brief SDA/SCL-adjacent electrical transients.
 *      This lines up with every piece of prior evidence: the original
 *      storm's cadence tracked I2C activity, not any plausible touch
 *      cadence; a later calibration test's rapid on-demand I2C polling
 *      produced near-identical interrupt-count-per-I2C-transaction
 *      bursts; and the storm went completely silent the instant that
 *      polling stopped. In short: a chatter -> reopen -> more chatter
 *      feedback loop, self-inflicted by this file, not the sensor or the
 *      GPIO3 wiring. Fixed here: I2C is opened ONCE in vcnl3020_init(),
 *      never preemptively reopened - vcnl3020_i2c_reopen() now only runs
 *      as a one-shot recovery retry on an actual I2C failure (preserving
 *      the legitimate long-idle-BMPS recovery case without the
 *      per-access churn).
 *   2. Unnecessary complexity: this file also used to dynamically re-arm
 *      a single "live" threshold boundary per transition (Schmitt-trigger
 *      style, see the old vcnl3020_arm_next_transition()). The working
 *      standalone demo does none of that - static LOW=0/HIGH=
 *      VCNL3020_THRESHOLD_HIGH, written once, with the host deciding
 *      CLOSED/OPEN by comparing the raw proximity value against
 *      VCNL3020_THRESHOLD_HIGH directly (not from which Interrupt Status
 *      Register bit fired). Simpler, and now proven correct on this exact
 *      hardware/threshold - ported as-is.
 *
 * Architecture otherwise unchanged: the sensor free-runs self-timed
 * proximity measurements in the background (VCNL3020_PROX_RATE_SELECT)
 * and compares each result against the threshold registers entirely in
 * its own hardware, asserting its open-drain /INT pin only when a
 * measurement crosses VCNL3020_THRESHOLD_HIGH. The host does zero polling
 * of the sensor - vcnl3020_gpio_isr() below just notifies the owning task
 * (see vcnl3020_init()) and returns; that task calls
 * vcnl3020_service_interrupt() to do the actual I2C work, entirely
 * outside of interrupt context.
 *
 * Register map (Vishay datasheet: https://www.vishay.com/docs/84150/
 * vcnl3020.pdf):
 *
 *   0x80  Command Register (#0)             - selftimed_en/prox_en control bits
 *   0x82  Proximity Rate Register (#2)      - self-timed measurement rate
 *   0x83  IR LED Current Register (#3)      - drive current, 10 mA/step, 0-20 (0-200 mA)
 *   0x87  Proximity Result MSB (#7)  \_ 16-bit result, MSB-first
 *   0x88  Proximity Result LSB (#8)  /
 *   0x89  Interrupt Control Register (#9)   - threshold-interrupt enable + debounce
 *   0x8A  Low Threshold, high byte (#10) \_ 16-bit, MSB-first
 *   0x8B  Low Threshold, low byte (#11)  /
 *   0x8C  High Threshold, high byte (#12) \_ 16-bit, MSB-first
 *   0x8D  High Threshold, low byte (#13)  /
 *   0x8E  Interrupt Status Register (#14)   - read to see which threshold
 *                                              fired, write 1 to the same
 *                                              bit(s) to clear/acknowledge
 *                                              (still done here to release
 *                                              /INT, just not used to
 *                                              decide CLOSED/OPEN anymore)
 */

#include <stdint.h>
#include <stdio.h>
#include <string.h>

#include "FreeRTOS.h"
#include "task.h"

#include "qapi_i2c.h"
#include "qapi_gpio.h"

#include "vcnl3020.h"

/* Fixed 7-bit I2C slave address for every VCNL3020 - no address strap. */
#define VCNL3020_I2C_ADDR              0x13

#define VCNL3020_REG_COMMAND           0x80
#define VCNL3020_REG_PROXIMITY_RATE    0x82
#define VCNL3020_REG_IR_LED_CURRENT    0x83
#define VCNL3020_REG_PROX_RESULT_MSB   0x87
#define VCNL3020_REG_PROX_RESULT_LSB   0x88
#define VCNL3020_REG_ICR               0x89
#define VCNL3020_REG_LOW_THR_HI        0x8A
#define VCNL3020_REG_LOW_THR_LO        0x8B
#define VCNL3020_REG_HIGH_THR_HI       0x8C
#define VCNL3020_REG_HIGH_THR_LO       0x8D
#define VCNL3020_REG_ISR               0x8E

/* Command Register (0x80) bits. */
#define VCNL3020_CMD_SELFTIMED_EN_BIT  (1U << 0)  /* write 1: enable the state machine/LP oscillator for autonomous measurement */
#define VCNL3020_CMD_PROX_EN_BIT       (1U << 1)  /* write 1: enable periodic proximity measurement (used with selftimed_en) */

/* Interrupt Control Register (0x89) bits/fields. */
#define VCNL3020_ICR_THRES_EN_BIT      (1U << 1)  /* write 1: enable threshold-crossing interrupt generation */
#define VCNL3020_ICR_COUNT_EXCEED_SHIFT 5U        /* bits 7:5: consecutive-out-of-window samples required before /INT asserts, see VCNL3020_INT_COUNT_EXCEED */

/* Interrupt Status Register (0x8E) bits - read+cleared to release /INT,
 * no longer used to decide CLOSED/OPEN (see this file's top comment). */
#define VCNL3020_ISR_TH_HI_BIT         (1U << 0)
#define VCNL3020_ISR_TH_LOW_BIT        (1U << 1)

#define info_printf(msg, ...) printf("VCNL3020: " msg, ##__VA_ARGS__)

static TaskHandle_t s_notify_task;

/* ------------------------------------------------------------------ */
/*  Low-level register access                                          */
/* ------------------------------------------------------------------ */

static int vcnl3020_write_reg(uint8_t reg, uint8_t val)
{
    uint8_t buf[2] = { reg, val };
    qapi_I2CM_Transfer_Config_t xcfg = {
        .BusFreqKHz = 100,
        .SlaveAddress = VCNL3020_I2C_ADDR,
        .SlaveMaxClockStretchUs = 0,
        .Delay = 0,
        .NoiseReject = 0,
    };
    qapi_I2CM_Descriptor_t wr = {
        .Buffer = buf,
        .Length = 2,
        .Transferred = 0,
        .Flags = QAPI_I2C_FLAG_START | QAPI_I2C_FLAG_STOP | QAPI_I2C_FLAG_WRITE,
    };

    return (qapi_I2CM_Transfer(VCNL3020_I2C_INSTANCE, &xcfg, &wr, 1, NULL, NULL) == QAPI_OK) ? 0 : -1;
}

static int vcnl3020_read_reg(uint8_t reg, uint8_t *val)
{
    qapi_I2CM_Transfer_Config_t xcfg = {
        .BusFreqKHz = 100,
        .SlaveAddress = VCNL3020_I2C_ADDR,
        .SlaveMaxClockStretchUs = 0,
        .Delay = 0,
        .NoiseReject = 0,
    };
    /* Two separate START+STOP transfers (address-write, then data-read)
     * rather than one repeated-start transfer - matches the pattern
     * already proven against this SDK's I2C driver/instance. */
    qapi_I2CM_Descriptor_t wr = {
        .Buffer = &reg,
        .Length = 1,
        .Transferred = 0,
        .Flags = QAPI_I2C_FLAG_START | QAPI_I2C_FLAG_STOP | QAPI_I2C_FLAG_WRITE,
    };
    qapi_I2CM_Descriptor_t rd = {
        .Buffer = val,
        .Length = 1,
        .Transferred = 0,
        .Flags = QAPI_I2C_FLAG_START | QAPI_I2C_FLAG_STOP | QAPI_I2C_FLAG_READ,
    };

    if (qapi_I2CM_Transfer(VCNL3020_I2C_INSTANCE, &xcfg, &wr, 1, NULL, NULL) != QAPI_OK)
        return -1;

    if (qapi_I2CM_Transfer(VCNL3020_I2C_INSTANCE, &xcfg, &rd, 1, NULL, NULL) != QAPI_OK)
        return -1;

    return 0;
}

static int vcnl3020_read_result_once(uint16_t *out_proximity)
{
    uint8_t msb, lsb;

    if (vcnl3020_read_reg(VCNL3020_REG_PROX_RESULT_MSB, &msb) != 0 ||
        vcnl3020_read_reg(VCNL3020_REG_PROX_RESULT_LSB, &lsb) != 0)
        return -1;

    *out_proximity = ((uint16_t)msb << 8) | lsb;
    return 0;
}

/* Close+reopen the host I2C instance. Host-controller-side workaround for
 * a REAL, previously-observed issue (I2C peripheral state going stale
 * after a long WLAN BMPS/DTIM10 idle period - same root cause documented
 * for this SDK's SHT40 sensor code). Deliberately NOT called before every
 * access anymore - see this file's top comment for why that was actually
 * the cause of the interrupt storm this file used to have. Now only
 * invoked as a one-shot recovery retry when an access has already failed
 * once (see vcnl3020_i2c_retry() below) - never preemptively. */
static int vcnl3020_i2c_reopen(void)
{
    /* qbool_t: 1 = Blocking mode / DMA on, 0 = Nonblocking / FIFO - using
     * the literal values (rather than TRUE/FALSE) avoids depending on
     * whichever transitive header happens to define those macros; this
     * file's include set doesn't pull one in (confirmed by an actual
     * build failure, "'TRUE' undeclared", earlier in this file's history
     * when it used TRUE/FALSE here). */
    qapi_I2CM_Config_t cfg = { .Blocking = 1, .Dma = 0 };
    qapi_Status_t status;

    qapi_I2CM_Close(VCNL3020_I2C_INSTANCE);
    status = qapi_I2CM_Open(VCNL3020_I2C_INSTANCE, &cfg);
    if (status != QAPI_OK) {
        info_printf("I2C open failed, status=%d\n", (int)status);
        return -1;
    }
    return 0;
}

/* ------------------------------------------------------------------ */
/*  GPIO interrupt (VCNL3020 /INT)                                     */
/* ------------------------------------------------------------------ */

/* Runs in GPIO interrupt-controller context - bare minimum only (no I2C,
 * no printf).
 *
 * EDGE_FALLING, not level-triggered, and that choice is load-bearing:
 * the VCNL3020's /INT stays asserted low until the owning task clears
 * VCNL3020_REG_ISR over I2C, and a level trigger left enabled during that
 * window would re-fire the instant this ISR returns - forever, without
 * ever letting the notified task run (an interrupt-storm lockup,
 * reproduced on hardware by this SDK's contact_sensor_task.c during its
 * own development). Masking the level interrupt here via
 * qapi_GPIO_Disable_Interrupt() is illegal from actual ISR context on
 * this RTOS port (that API takes a critical section FreeRTOS's ARM_CM4F
 * port asserts on outside task context - also reproduced on hardware).
 * EDGE_FALLING sidesteps the problem entirely: it fires exactly once per
 * high-to-low transition regardless of how long the line then stays low,
 * so nothing needs masking/unmasking - the interrupt just stays enabled
 * permanently after the one qapi_GPIO_Enable_Interrupt() call in
 * vcnl3020_init(). */
static void vcnl3020_gpio_isr(qapi_GPIO_CB_Data_t data)
{
    BaseType_t woken = pdFALSE;

    (void)data;

    if (s_notify_task != NULL) {
        xTaskNotifyFromISR(s_notify_task, VCNL3020_NOTIFY_BIT, eSetBits, &woken);
        portYIELD_FROM_ISR(woken);
    }
}

/* ------------------------------------------------------------------ */
/*  Public API                                                         */
/* ------------------------------------------------------------------ */

int vcnl3020_init(void)
{
    qapi_GPIO_Config_t gpio_cfg;
    uint8_t led_reg = (uint8_t)(VCNL3020_LED_CURRENT_MA / 10U);
    uint8_t icr = VCNL3020_ICR_THRES_EN_BIT |
                  (uint8_t)(VCNL3020_INT_COUNT_EXCEED << VCNL3020_ICR_COUNT_EXCEED_SHIFT);

    /* Whichever task calls this owns servicing VCNL3020_NOTIFY_BIT from
     * here on - see vcnl3020.h. Captured before anything below can
     * possibly race a real interrupt. */
    s_notify_task = xTaskGetCurrentTaskHandle();

    /* Opened ONCE here - not reopened before every access anymore, see
     * this file's top comment. */
    if (vcnl3020_i2c_reopen() != 0)
        return -1;

    /* Register 0x83: IR LED drive current, 10 mA per LSB. */
    if (vcnl3020_write_reg(VCNL3020_REG_IR_LED_CURRENT, led_reg) != 0) {
        info_printf("LED current write failed\n");
        return -1;
    }

    /* Register 0x82: self-timed measurement rate. */
    if (vcnl3020_write_reg(VCNL3020_REG_PROXIMITY_RATE, VCNL3020_PROX_RATE_SELECT) != 0) {
        info_printf("proximity rate write failed\n");
        return -1;
    }

    /* Registers 0x8A-0x8D: static LOW=VCNL3020_THRESHOLD_LOW(0)/
     * HIGH=VCNL3020_THRESHOLD_HIGH - written once, never re-armed. See
     * this file's top comment for why the old dynamic re-arming scheme
     * was dropped. */
    if (vcnl3020_write_reg(VCNL3020_REG_LOW_THR_HI, (uint8_t)(VCNL3020_THRESHOLD_LOW >> 8)) != 0 ||
        vcnl3020_write_reg(VCNL3020_REG_LOW_THR_LO, (uint8_t)(VCNL3020_THRESHOLD_LOW & 0xFF)) != 0 ||
        vcnl3020_write_reg(VCNL3020_REG_HIGH_THR_HI, (uint8_t)(VCNL3020_THRESHOLD_HIGH >> 8)) != 0 ||
        vcnl3020_write_reg(VCNL3020_REG_HIGH_THR_LO, (uint8_t)(VCNL3020_THRESHOLD_HIGH & 0xFF)) != 0) {
        info_printf("threshold write failed\n");
        return -1;
    }

    /* Register 0x89: threshold interrupt enabled, debounced by
     * VCNL3020_INT_COUNT_EXCEED consecutive out-of-window samples,
     * INT_PROX_READY_EN deliberately left OFF (bit not set) - no
     * interrupt on every single measurement, threshold crossings only. */
    if (vcnl3020_write_reg(VCNL3020_REG_ICR, icr) != 0) {
        info_printf("interrupt control write failed\n");
        return -1;
    }

    /* Register 0x80: selftimed_en MUST be set before prox_en per the
     * datasheet, hence two separate writes rather than one combined one. */
    if (vcnl3020_write_reg(VCNL3020_REG_COMMAND, VCNL3020_CMD_SELFTIMED_EN_BIT) != 0) {
        info_printf("selftimed_en write failed\n");
        return -1;
    }
    if (vcnl3020_write_reg(VCNL3020_REG_COMMAND,
            VCNL3020_CMD_SELFTIMED_EN_BIT | VCNL3020_CMD_PROX_EN_BIT) != 0) {
        info_printf("prox_en write failed\n");
        return -1;
    }

    /* qapi_GPIO_Init() is declared in qapi_gpio.h but is NOT linked into
     * this image (confirmed by contact_sensor_task.c: an actual link
     * failure, "undefined reference to qapi_GPIO_Init", when it called
     * it) - board bring-up already handles whatever it would have done.
     * Do not call it. GPIO3 registered LAST, after selftimed_en/prox_en
     * are already set - matches the proven-working standalone demo's
     * ordering. */
    memset(&gpio_cfg, 0, sizeof(gpio_cfg));
    gpio_cfg.Dir = QAPI_GPIO_INPUT_E;
    gpio_cfg.Pull = QAPI_GPIO_PULL_UP_E; /* backup for the recommended external pull-up - see VCNL3020_INT_GPIO_ID's comment */
    gpio_cfg.Drive = QAPI_GPIO_DRIVE_LOW_E; /* irrelevant for an input, kept in a defined state */
    qapi_GPIO_Config(VCNL3020_INT_GPIO_ID, &gpio_cfg);

    qapi_GPIO_Enable_Interrupt(VCNL3020_INT_GPIO_ID, QAPI_GPIO_TRIGGER_EDGE_FALLING_E, vcnl3020_gpio_isr, 0);

    info_printf("armed: self-timed + threshold interrupt on GPIO%d, HIGH=%u, LED=%umA\n",
        (int)VCNL3020_INT_GPIO_ID, (unsigned)VCNL3020_THRESHOLD_HIGH, (unsigned)VCNL3020_LED_CURRENT_MA);

    return 0;
}

int vcnl3020_service_interrupt(uint16_t *out_proximity)
{
    uint8_t isr = 0;

    /* Read + clear the Interrupt Status Register - releases the
     * open-drain /INT line so future interrupts can fire. Content not
     * used to decide CLOSED/OPEN anymore - see this file's top comment. */
    if (vcnl3020_read_reg(VCNL3020_REG_ISR, &isr) != 0) {
        if (vcnl3020_i2c_reopen() != 0)
            return -1;
        if (vcnl3020_read_reg(VCNL3020_REG_ISR, &isr) != 0)
            return -1;
    }

    isr &= (VCNL3020_ISR_TH_HI_BIT | VCNL3020_ISR_TH_LOW_BIT);
    if (isr != 0 && vcnl3020_write_reg(VCNL3020_REG_ISR, isr) != 0)
        return -1;

    if (vcnl3020_read_result_once(out_proximity) != 0) {
        if (vcnl3020_i2c_reopen() != 0)
            return -1;
        if (vcnl3020_read_result_once(out_proximity) != 0)
            return -1;
    }

    return 0;
}

int vcnl3020_read_result(uint16_t *out_proximity)
{
    if (vcnl3020_read_result_once(out_proximity) == 0)
        return 0;

    /* One recovery attempt - the I2C peripheral may have gone stale after
     * a long BMPS/DTIM10 idle gap (the periodic MQTT-tick caller of this
     * function can go up to MQTT_PUBLISH_INTERVAL_MS, ~10 min, between
     * calls). NOT done preemptively - see this file's top comment. */
    if (vcnl3020_i2c_reopen() != 0)
        return -1;

    return vcnl3020_read_result_once(out_proximity);
}
```

## src/vcnl3020.h
```c
/*
 * Copyright (c) 2026 Qualcomm Innovation Center, Inc. All rights reserved.
 * SPDX-License-Identifier: BSD-3-Clause-Clear
 */

/* Vishay VCNL3020 IR proximity sensor - I2C, INTERRUPT-DRIVEN.
 *
 * This is a direct port of the design proven out in the standalone
 * demo/vcnl3020_test_demo (no WLAN/MQTT/DTIM at all) - confirmed on
 * hardware there: silent at idle, one clean STATUS transition per real
 * touch/release, silent again with /INT physically disconnected (no
 * floating-pin chatter). Two things changed from THIS file's own earlier
 * attempt, both root-caused by comparing against that working demo - see
 * vcnl3020.c's top-of-file comment for the full writeup:
 *   1. No more per-I2C-access "close+reopen" (vcnl3020_i2c_reopen() used
 *      to run before every single register access) - that pattern is the
 *      leading suspect for the original ~95ms interrupt storm, not real
 *      touch events or board wiring. I2C is now opened once in
 *      vcnl3020_init() and only reopened as an on-failure recovery retry.
 *   2. No more dynamic per-transition threshold re-arming
 *      (vcnl3020_arm_next_transition()/s_armed_low). LOW is pinned to 0
 *      and HIGH=VCNL3020_THRESHOLD_HIGH, both static, written once. The
 *      STATUS decision compares the raw proximity value against
 *      VCNL3020_THRESHOLD_HIGH directly, the same way the working
 *      standalone demo does - not from which Interrupt Status Register
 *      bit fired.
 *
 * Wiring: SDA, SCL, VDD, GND as before, PLUS /INT -> VCNL3020_INT_GPIO_ID
 * with a pull-up (external ~10k to 3V3 recommended, matches an open-drain
 * interrupt line - see that macro's comment for why EXT_WAKEUP is NOT used
 * here despite being the originally-proposed pin).
 */

#ifndef VCNL3020_H
#define VCNL3020_H

#include <stdint.h>

#include "qapi_gpio.h"

/* IR LED drive current used for every self-timed measurement, in mA.
 * Register 0x83 takes this in 10 mA steps (0-200 mA, i.e. 0-20 decimal).
 * Higher = more reflected IR = larger raw counts/longer range, at the cost
 * of more current per conversion (the sensor is now converting
 * continuously in the background at VCNL3020_PROX_RATE_SELECT's rate,
 * regardless of host activity, so this directly sets the sensor's own
 * average current draw). Must be a multiple of 10 between 0 and 200. */
#define VCNL3020_LED_CURRENT_MA        20U

/* qapi_I2CM_Transfer() I2C instance the sensor is wired to. */
#define VCNL3020_I2C_INSTANCE          QAPI_I2C_INSTANCE_SE0_E

/* Proximity Rate register (0x82) value - how often the sensor measures on
 * its own; raw index 0-7 (low 3 bits only):
 *   0: 1.95 measurements/s (~513ms period, used here - lowest power)
 *   1: 3.90625/s   2: 7.8125/s   3: 15.625/s
 *   4: 31.25/s     5: 62.5/s     6: 125/s      7: 250/s
 * Governs both how quickly a real crossing is noticed (worst case ~1
 * period later) and the sensor's own average current, since it measures
 * continuously in the background regardless of whether the host is awake.
 * Appropriate for slow-changing proximity events per the datasheet default. */
#define VCNL3020_PROX_RATE_SELECT      0U

/* Interrupt Control Register (0x89) int_count_exceed field (bits 7:5) -
 * how many CONSECUTIVE self-timed measurements must land outside the
 * armed threshold before /INT actually asserts, i.e. hardware debounce
 * against a single noisy sample. Raw 3-bit field value -> consecutive
 * count required:
 *   0: 1   1: 2   2: 4   3: 8   4: 16   5: 32   6: 64   7: 128
 * Default here is 1 (2 consecutive samples, ~1s worst-case extra latency
 * at the default VCNL3020_PROX_RATE_SELECT). */
#define VCNL3020_INT_COUNT_EXCEED      1U

/* CONFIRMED WORKING on hardware via demo/vcnl3020_test_demo: proximity >=
 * this -> CLOSED (object detected), else OPEN. Idle baseline measured
 * ~2150-2160; this threshold cleanly separated touched/covered from clear
 * across repeated tests in that standalone demo. LOW is intentionally
 * fixed at 0 (unreachable - proximity is unsigned) and never changed; the
 * sensor's interrupt comparator needs some low-threshold value
 * programmed, this just keeps that side permanently inert - only
 * VCNL3020_THRESHOLD_HIGH is meaningful here. */
#define VCNL3020_THRESHOLD_HIGH        3000U
#define VCNL3020_THRESHOLD_LOW         0U

/* VCNL3020 /INT is OPEN-DRAIN, active LOW - needs a pull-up (external
 * ~10k to 3.3V recommended; QAPI_GPIO_PULL_UP_E in vcnl3020_init() enables
 * the SoC's own, usually weaker, internal pull-up as a backup only).
 *
 * NOTE: the originally-proposed wiring target was the SoC's EXT_WAKEUP pin
 * (chip pin 22). That pin is NOT usable here: it is a dedicated PMU/AON
 * pin wired directly into this SDK's own deep-sleep (IMPS) wake sequencer
 * (see PMU_AON_LIC_INT_* registers in modules/hal/inc/qcc730v2.h and the
 * low-level handling in modules/core/system/sys_src/nt_socpm_sleep.c /
 * wifi_fw_ext_intr.c) - there is no qapi_GPIO_Enable_Interrupt()-style
 * application callback hook exposed for it, and this demo runs BMPS/
 * DTIM10 (ENABLE_IMPS_DEEPSLEEP 0 in powertest_demo.c), not IMPS deep
 * sleep, so that wake path is never even entered. Under BMPS the CPU is
 * always running FreeRTOS (idle-task WFI at most - see the "wakebmps"
 * clarification this repo's contact_sensor_task.c already worked out on
 * hardware), so a plain numbered GPIO with qapi_GPIO_Enable_Interrupt() is
 * both necessary and sufficient. GPIO3 is confirmed working (see this
 * file's top comment) and free of I2C/JTAG conflicts on this DevKit -
 * physically wire /INT (and its pull-up) to the GPIO3 header pin, NOT
 * EXT_WAKEUP. */
#define VCNL3020_INT_GPIO_ID           QAPI_GPIO_ID3_E

/* xTaskNotify() bit this driver sets (via xTaskNotifyFromISR(), from
 * vcnl3020_gpio_isr()) on whichever task called vcnl3020_init() - that
 * task owns responding to it (typically by calling
 * vcnl3020_service_interrupt() and publishing the result), NOT this
 * driver. Pick a bit that doesn't collide with any other notify bit the
 * calling task already uses. */
#define VCNL3020_NOTIFY_BIT            (1U << 0)

/* One-time setup, call from the task that will own sensor events (it is
 * captured internally via xTaskGetCurrentTaskHandle() as the
 * VCNL3020_NOTIFY_BIT target - see above):
 *   - opens I2C (once - see this file's top comment)
 *   - programs LED current (0x83) and proximity rate (0x82)
 *   - programs the static LOW=0/HIGH=VCNL3020_THRESHOLD_HIGH threshold
 *     registers (0x8A-0x8D)
 *   - programs the Interrupt Control Register (0x89): INT_THRES_EN with
 *     the debounce count above, INT_PROX_READY_EN left OFF (no
 *     interrupt-per-measurement, threshold crossings only)
 *   - enables self-timed continuous measurement (Command Register 0x80:
 *     selftimed_en, THEN prox_en in a second write, per datasheet ordering)
 *   - configures VCNL3020_INT_GPIO_ID as an edge-triggered input interrupt
 * Safe to call again later to recover from a service failure (see
 * vcnl3020_service_interrupt()). Returns 0 on success, -1 on I2C failure. */
int vcnl3020_init(void);

/* Call after waking on VCNL3020_NOTIFY_BIT. Reads + clears the sensor's
 * Interrupt Status Register (0x8E, releasing the open-drain /INT line so
 * future interrupts can fire) and reads the current proximity result
 * (0x87/0x88) into *out_proximity - unconditionally, regardless of which
 * (if any) bit 0x8E reported; the caller decides CLOSED/OPEN by comparing
 * *out_proximity against VCNL3020_THRESHOLD_HIGH itself (matching the
 * proven standalone-demo design - see this file's top comment).
 *
 * Returns 0 on success, -1 on I2C failure (caller should call
 * vcnl3020_init() again to recover - this function already attempts one
 * internal close+reopen retry on failure before giving up). */
int vcnl3020_service_interrupt(uint16_t *out_proximity);

/* On-demand direct read of the latest self-timed result (0x87/0x88) -
 * does NOT touch the Interrupt Status Register. Safe to call any time
 * (e.g. from a periodic MQTT-keepalive tick, independent of interrupt
 * servicing) since the sensor is continuously self-timing regardless of
 * whether the host is reading it. Returns 0 on success, -1 on I2C failure. */
int vcnl3020_read_result(uint16_t *out_proximity);

#endif /* VCNL3020_H */
```
