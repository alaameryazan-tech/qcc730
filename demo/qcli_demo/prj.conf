## prj.conf
```kconfig
#
# qcli_demo setting
#
CONFIG_QCCSDK_DEMO=y
CONFIG_QCCSDK_CONSOLE=y
CONFIG_FLASH_SHELL=y
CONFIG_FREERTOS_PLUS_POSIX=y

CONFIG_WIFI_SHELL=y
CONFIG_WLAN_QAPI=y
CONFIG_PLATFORM_SHELL=y
CONFIG_LOWPOWER_SHELL=y
CONFIG_UNITTEST_SHELL=y
CONFIG_I2CM_SHELL=y
CONFIG_GPIO_SHELL=y
CONFIG_NET_SHELL=y
CONFIG_UART_SHELL=n
CONFIG_LWIP_HEAP_POOL=y
CONFIG_6GHZ=y
CONFIG_6G_BAND=y
CONFIG_RTT_VIEW_CLI=n

CONFIG_WATCH_DOG_ENABLE=n
CONFIG_WATCH_DOG_BITE_TIME=8
CONFIG_FW_UPGRADE=y
CONFIG_FILE_SYSTEM=y
CONFIG_FILE_SYSTEM_LITTLEFS=y
CONFIG_POSIX_FS_API=y
CONFIG_FS_SHELL=y
CONFIG_MPU_DEMO=y
CONFIG_MQTT_CLIENT=y
CONFIG_MQTT_CLIENT_DEMO=y
#CONFIG_SIGMA_TRAFFIC=n
CONFIG_RING_IF_ONLY=n
CONFIG_QCSPI_HFC_TEST=n
CONFIG_QCSPI_HFC_ETH_ENABLE=n
CONFIG_HTTP_CLIENT=y
CONFIG_HTTP_SERVER=y
CONFIG_HTTP_CLIENT_DEMO=y
CONFIG_HTTP_SERVER_DEMO=y
CONFIG_MGMT_FILTER_DEMO=y
CONFIG_RNG_TEST=y
CONFIG_SNTP_CLIENT=y
CONFIG_SNTP_CLIENT_DEMO=y
CONFIG_ACK_TIMEOUT_MODIFY_ENABLE=y
CONFIG_WIFI_FW_COREDUMP_SUPPORT=y
CONFIG_WIFI_FW_RAMDUMP_PRINT_FLAG=0
#CONFIG_SRRC_BAND_EDGE_SUPPORT=n
#CONFIG_HEAVY_CLIP_ENABLE=y
#CONFIG_HEAVY_CLIP_BOARDS_TYPE=1
#CONFIG_HEAVY_CLIP_LEVEL_2G=1
#CONFIG_HEAVY_CLIP_LEVEL_5G=0
CONFIG_BOARD_EVB_I2C_OPTION=n
CONFIG_MBEDTLS_AES_ALT=n
CONFIG_MBEDTLS_CCM_ALT=n
CONFIG_MBEDTLS_SHA_ALT=n
CONFIG_WPS=y
CONFIG_WPS_LIB=y
CONFIG_ENABLE_P2P_MODE=n
CONFIG_ENABLE_P2P_LIB=n
CONFIG_LWIP_MULTIPLE_STREAMS=n
CONFIG_SUPPORT_LWIP_RAW_SOCKET=n
CONFIG_TOTAL_BEACON_WAIT_TIME=25000
CONFIG_SECUREFS_DEMO=y
CONFIG_NO_STDOUT_DEBUG=n
CONFIG_ENABLE_SUPPLICANT=n
CONFIG_WLAN_8021X=n

CONFIG_XO_USE_BDF_OVERRIDE=n
CONFIG_SAT_STEP_MANUAL_ADJUSTMENT=n
# CONFIG_SAT_STEP_2G_SS=0x00000060
# CONFIG_SAT_STEP_2G_TT=0x00000060
# CONFIG_SAT_STEP_2G_FF=0x00000064
# CONFIG_SAT_STEP_5G_SS=0x00000064
# CONFIG_SAT_STEP_5G_TT=0x00000064
# CONFIG_SAT_STEP_5G_FF=0x00000064

# end of qcli_demo setting
```

## prj_mem_kpi.conf
```kconfig
#
# qcli_demo setting for Memroy KPI
#
CONFIG_QCCSDK_DEMO=y
CONFIG_QCCSDK_CONSOLE=y
CONFIG_FLASH_SHELL=y
CONFIG_FREERTOS_PLUS_POSIX=y

CONFIG_WIFI_SHELL=y
CONFIG_WLAN_QAPI=y
CONFIG_PLATFORM_SHELL=y
CONFIG_LOWPOWER_SHELL=y
CONFIG_UNITTEST_SHELL=y
CONFIG_I2CM_SHELL=y
CONFIG_GPIO_SHELL=y
CONFIG_NET_SHELL=y
CONFIG_UART_SHELL=n
CONFIG_LWIP_HEAP_POOL=y
CONFIG_6GHZ=y
CONFIG_6G_BAND=y
CONFIG_RTT_VIEW_CLI=n

CONFIG_WATCH_DOG_ENABLE=n
CONFIG_WATCH_DOG_BARK_TIME=4
CONFIG_WATCH_DOG_BITE_TIME=5
CONFIG_FW_UPGRADE=y
CONFIG_FILE_SYSTEM=y
CONFIG_FILE_SYSTEM_LITTLEFS=y
CONFIG_POSIX_FS_API=y
CONFIG_FS_SHELL=y
CONFIG_MPU_DEMO=y
CONFIG_MQTT_CLIENT=y
CONFIG_MQTT_CLIENT_DEMO=n
#CONFIG_SIGMA_TRAFFIC=n
CONFIG_RING_IF_ONLY=n
CONFIG_QCSPI_HFC_TEST=n
CONFIG_QCSPI_HFC_ETH_ENABLE=n
CONFIG_HTTP_CLIENT=y
CONFIG_HTTP_CLIENT_DEMO=y
CONFIG_MGMT_FILTER_DEMO=y
CONFIG_RNG_TEST=y
CONFIG_SNTP_CLIENT=y
CONFIG_SNTP_CLIENT_DEMO=n
CONFIG_ACK_TIMEOUT_MODIFY_ENABLE=y
#CONFIG_SRRC_BAND_EDGE_SUPPORT=n
#CONFIG_HEAVY_CLIP_ENABLE=n
#CONFIG_HEAVY_CLIP_LEVEL_2G=0
#CONFIG_HEAVY_CLIP_LEVEL_5G=0

CONFIG_MBEDTLS_AES_ALT=n
CONFIG_MBEDTLS_CCM_ALT=n
CONFIG_MBEDTLS_SHA_ALT=n
CONFIG_WPS=y
CONFIG_WPS_LIB=y
CONFIG_ENABLE_P2P_MODE=n
CONFIG_ENABLE_P2P_LIB=n
CONFIG_LWIP_MULTIPLE_STREAMS=n
CONFIG_SECUREFS_DEMO=y

CONFIG_XO_USE_BDF_OVERRIDE=n
CONFIG_SAT_STEP_MANUAL_ADJUSTMENT=n
# CONFIG_SAT_STEP_2G_SS=0x00000060
# CONFIG_SAT_STEP_2G_TT=0x00000060
# CONFIG_SAT_STEP_2G_FF=0x00000064
# CONFIG_SAT_STEP_5G_SS=0x00000064
# CONFIG_SAT_STEP_5G_TT=0x00000064
# CONFIG_SAT_STEP_5G_FF=0x00000064

# end of qcli_demo setting
```

## src/qcli_demo_main.c
```c
/*
#Copyright (c) 2024 Qualcomm Innovation Center, Inc. All rights reserved.
#SPDX-License-Identifier: BSD-3-Clause-Clear
 */

#include <string.h>
#include <stdint.h>

#include <stdio.h>
#include <stdlib.h>

#include "qcli.h"
#include "qcli_api.h"

#include "wmi.h"
#include "FreeRTOS.h"
#include "semphr.h"

#include "nt_wfm_wmi_interface.h"
#include <nt_ftm.h>

#include "wlan_dev.h"
#include "qapi_wlan.h"
#include "qurt_internal.h"
#include "safeAPI.h"
#include "ip_addr.h"
#include "netif.h"
#include "dhcp.h"
#include "network_al.h"

#define WIFI_SSID        "FRITZ!Box7590AX"
#define WIFI_PASSPHRASE  "Tech91847"
#define WIFI_DEV_STA_ID  1

volatile qbool_t g_wifi_auto_connected = false;

static void wifi_auto_event_cb(__unused uint8_t deviceId, uint32_t cbId,
                               __unused void *pAppCtx, void *payload,
                               __unused uint32_t len)
{
    if (cbId == QAPI_WLAN_CONNECT_CB_E) {
        qapi_WLAN_Join_Comp_Evt_t *info = (qapi_WLAN_Join_Comp_Evt_t *)payload;
        if (info->evt_hdr.status == QAPI_OK && info->bss_Connection_Status) {
            g_wifi_auto_connected = true;
            printf("WiFi: connected to %s\n", WIFI_SSID);
        } else {
            printf("WiFi: connect failed, reason %d\n", info->reason_code);
        }
    }
}

static void wifi_auto_connect_task(__unused void *arg)
{
    qapi_WLAN_DEV_Mode_e devMode   = DEV_MODE_STATION_E;
    qapi_WLAN_Auth_Mode_e authMode = QAPI_WLAN_AUTH_WPA3_SAE_E; /* WPA3-Personal (SAE) */
    qapi_WLAN_Crypt_Type_e cipher  = QAPI_WLAN_CRYPT_AES_CRYPT_E;
    const char *ssid       = WIFI_SSID;
    const char *passphrase = WIFI_PASSPHRASE;

    qapi_WLAN_Set_Callback(wifi_auto_event_cb, NULL);
    qapi_WLAN_Enable(true);

    qapi_WLAN_Set_Param(WIFI_DEV_STA_ID, __QAPI_WLAN_PARAM_GROUP_WIRELESS,
                        __QAPI_WLAN_PARAM_GROUP_WIRELESS_OPERATION_MODE,
                        &devMode, sizeof(devMode), FALSE);

    qapi_WLAN_Set_Param(WIFI_DEV_STA_ID, __QAPI_WLAN_PARAM_GROUP_WIRELESS_SECURITY,
                        __QAPI_WLAN_PARAM_GROUP_SECURITY_AUTH_MODE,
                        &authMode, sizeof(authMode), FALSE);

    qapi_WLAN_Set_Param(WIFI_DEV_STA_ID, __QAPI_WLAN_PARAM_GROUP_WIRELESS_SECURITY,
                        __QAPI_WLAN_PARAM_GROUP_SECURITY_ENCRYPTION_TYPE,
                        &cipher, sizeof(cipher), FALSE);

    qapi_WLAN_Set_Param(WIFI_DEV_STA_ID, __QAPI_WLAN_PARAM_GROUP_WIRELESS_SECURITY,
                        __QAPI_WLAN_PARAM_GROUP_SECURITY_PASSPHRASE,
                        (void *)passphrase, strlen(passphrase), FALSE);

    qapi_WLAN_Set_Param(WIFI_DEV_STA_ID, __QAPI_WLAN_PARAM_GROUP_WIRELESS,
                        __QAPI_WLAN_PARAM_GROUP_WIRELESS_SSID,
                        (void *)ssid, strlen(ssid), FALSE);

    qapi_WLAN_Commit(WIFI_DEV_STA_ID);

    while (!g_wifi_auto_connected) {
        qurt_thread_sleep(200);
    }

    uint8_t netid = nt_get_netifidx_by_devmode(STA_DEVICE);
    struct netif *netif = netif_get_by_index(netid);
    if (netif) {
        netif_set_addr(netif, IP4_ADDR_ANY4, IP4_ADDR_ANY4, IP4_ADDR_ANY4);
        if (dhcp_start(netif) == ERR_OK) {
            printf("WiFi: DHCP started\n");
        }
    }

    nt_osal_thread_delete(NULL);
}
#ifdef CONFIG_FWUP_DEMO
#include "ota_demo.h"
#endif
#if CONFIG_MPU_DEMO
#include "mpu_demo.h"
#endif
#ifdef CONFIG_MGMT_FILTER_DEMO
#include "mgmt_filter_demo.h"
#endif

#ifdef FERMION_SILICON
extern uint32_t UART_Send_direct(char *txbuf, uint32_t buflen);
#define UART_SEND_DIRECT(str) UART_Send_direct((str), strlen(str))
#else
#define UART_SEND_DIRECT(str)
#endif

static volatile int dead_loop = 0;

/*
 * RTT/FTM QCLI demo
 */
extern qurt_pipe_t msg_wfm_wmi_id;

typedef struct {
    uint64_t t1;
    uint64_t t2;
    uint64_t t3;
    uint64_t t4;
    uint16_t fac;
    uint32_t base_delay;    /* from PHY/BDF (phyRTT_enable) */
    int32_t  rtt;           /* corrected RTT (time unit follows nt_rtt_calculation) */
    int32_t  tof;           /* rtt/2 */
    uint32_t distance_mm;   /* derived (approx) */
    uint8_t  valid;
    uint8_t  seq;
} rtt_sample_t;

static SemaphoreHandle_t g_rtt_sync_sem = NULL;
static uint32_t g_last_rtt_distance_cm = 0;
static int g_rtt_status = -1; /* 0 = Success, -1 = Fail */
QCLI_Group_Handle_t qcli_rtt_group;

/* Demo-side config cache (default) */
static usr_ftm g_cfg = {
    .ftm_mode = FTM_INITIATOR,
    .location = 0,
    .location_type = 0,
    .asap = 1,
    .ftms_per_burst = 4,
    .no_of_bur_exp = 0,
    .min_delta_ftm = 20,
    .burst_duration = 15,
    .burst_period = 0,
    .cal_val = 0,
    .format_and_bw = 0,
};
extern uint32_t g_dynamic_base_delay;
void nt_rtt_demo_notify(uint64_t dist_cm)
{
    g_last_rtt_distance_cm = (uint32_t)dist_cm;
    g_rtt_status = 0;

    if (g_rtt_sync_sem != NULL) {
        xSemaphoreGive(g_rtt_sync_sem);
    } else {
        printf("RTT Async: %u cm", (uint32_t)dist_cm);
    }
}

static void rtt_demo_print_connected_bssid(void)
{
#ifdef NT_DEV_STA_ID
    extern dev_common_t *gpDevCommon;
    if (gpDevCommon && gpDevCommon->devp[NT_DEV_STA_ID] && gpDevCommon->devp[NT_DEV_STA_ID]->bss) {
        devh_t *dev = gpDevCommon->devp[NT_DEV_STA_ID];
        uint8_t *bssid = dev->bss->ni_bssid;
        printf("RTT: Connected BSSID=%02x:%02x:%02x:%02x:%02x:%02x\n",
               bssid[0], bssid[1], bssid[2], bssid[3], bssid[4], bssid[5]);
        return;
    }
#endif
    printf("RTT: Connected BSSID=unknown");
}

static int util_parse_mac(const char *mac_str, uint8_t *mac_out)
{
    int values[6];
    if (sscanf(mac_str, "%x:%x:%x:%x:%x:%x",
               &values[0], &values[1], &values[2],
               &values[3], &values[4], &values[5]) == 6)
    {
        for (int i = 0; i < 6; ++i)
            mac_out[i] = (uint8_t)values[i];
        return 0;
    }
    return -1;
}

static int wmi_send_cmd(uint16_t cmd_id, void *data, uint16_t len)
{
    wmi_msg_struct_t msg;
    memset(&msg, 0x0, sizeof(msg));
    msg.msg_struct.return_status = eWiFiNotSupported;
    msg.trans_wmi_message_id = cmd_id;
    msg.msg_struct.vo_data = data;
    msg.msg_struct.vo_data_len = len;

    if (QURT_EOK != qurt_pipe_send_timed(msg_wfm_wmi_id, &msg, pdMS_TO_TICKS(100)))
    {
        printf("Error: Failed to send WMI command 0x%x", cmd_id);
        return -1;
    }
    return 0;
}

/* =========================================================================
 * CLI Commands
 * ========================================================================= */
static QCLI_Command_Status_t cmd_RTT_Cfg(uint32_t Parameter_Count, QCLI_Parameter_t *Parameter_List)
{
    /* Example: rtt_cfg ftms=8 delta=20 asap=1 bw=0 cal=0x0 */
    for (uint32_t i = 0; i < Parameter_Count; i++) { 
        const char *s = Parameter_List[i].String_Value;
        if (s == NULL || s[0] == 0) {
            continue;
        }

        if (strncmp(s, "ftms=", 5) == 0) g_cfg.ftms_per_burst = (uint8_t)atoi(s + 5);
        else if (strncmp(s, "delta=", 6) == 0) g_cfg.min_delta_ftm = (uint8_t)atoi(s + 6);
        else if (strncmp(s, "asap=", 5) == 0) g_cfg.asap = (uint8_t)atoi(s + 5);
        else if (strncmp(s, "bw=", 3) == 0) g_cfg.format_and_bw = (uint8_t)atoi(s + 3);
        else if (strncmp(s, "cal=", 4) == 0) g_cfg.cal_val = (uint32_t)strtoul(s + 4, NULL, 0);
        else if (strncmp(s, "dur=", 4) == 0) g_cfg.burst_duration = (uint8_t)atoi(s + 4);
        else if (strncmp(s, "period=", 7) == 0) g_cfg.burst_period = (uint16_t)atoi(s + 7);
    }

    printf("RTT CFG: ftms=%d delta=%d asap=%d bw=%d dur=%d period=%d cal=0x%x",
           g_cfg.ftms_per_burst, g_cfg.min_delta_ftm, g_cfg.asap, g_cfg.format_and_bw,
           g_cfg.burst_duration, g_cfg.burst_period, g_cfg.cal_val);
    return QCLI_STATUS_SUCCESS_E;
}
extern uint8_t g_rtt_index;
extern uint8_t g_ftm_number;
static QCLI_Command_Status_t cmd_RTT_Start(uint32_t Parameter_Count, QCLI_Parameter_t *Parameter_List)
{
    uint8_t target_mac[6];
    uint32_t burst_cnt = g_cfg.ftms_per_burst;
    g_ftm_number = g_cfg.ftms_per_burst;
    g_rtt_index = 0;

    if (Parameter_Count > 1 && Parameter_List[1].Integer_Is_Valid) {
        burst_cnt = (uint32_t)Parameter_List[1].Integer_Value;
    }

    rtt_demo_print_connected_bssid();

    if (g_rtt_sync_sem == NULL) {
        g_rtt_sync_sem = xSemaphoreCreateBinary();
    }

    xSemaphoreTake(g_rtt_sync_sem, 0);
    g_rtt_status = -1;

    usr_ftm ftm_config = g_cfg;
    ftm_config.ftm_mode = FTM_INITIATOR;
    ftm_config.ftms_per_burst = (uint8_t)burst_cnt;

    if (wmi_send_cmd(WMI_SET_RTT_CFG, &ftm_config, sizeof(ftm_config)) != 0) {
        return QCLI_STATUS_ERROR_E;
    }

    if (wmi_send_cmd(WMI_SEND_FTM_FRAME, NULL, 0) != 0) {
        return QCLI_STATUS_ERROR_E;
    }

    // if (xSemaphoreTake(g_rtt_sync_sem, pdMS_TO_TICKS(5000)) == pdTRUE) {
    //     if (g_rtt_status == 0) {
    //         printf("RTT SUCCESS: Distance = %u cm (%u mm)\n",
    //             (unsigned)(g_last_rtt_distance_mm / 10),
    //             (unsigned)g_last_rtt_distance_mm);
    //         return QCLI_STATUS_SUCCESS_E;
    //     }
    //     printf("RTT FAILED: no sample produced. Try rtt_dump.");
    //     return QCLI_STATUS_ERROR_E;
    // }
    printf("g_rtt_index=%d, g_ftm_number=%d\r\n", g_rtt_index, g_ftm_number);
    return QCLI_STATUS_SUCCESS_E;
}

static QCLI_Command_Status_t cmd_RTT_Status(uint32_t Parameter_Count, QCLI_Parameter_t *Parameter_List)
{
    (void)Parameter_Count;
    (void)Parameter_List;

    printf("RTT STATUS: last=%u cm, status=%d ", g_last_rtt_distance_cm, g_rtt_status);
    printf("RTT CFG: ftms=%d delta=%d asap=%d bw=%d dur=%d period=%d cal=0x%x",
           g_cfg.ftms_per_burst, g_cfg.min_delta_ftm, g_cfg.asap, g_cfg.format_and_bw,
           g_cfg.burst_duration, g_cfg.burst_period, g_cfg.cal_val);

    return QCLI_STATUS_SUCCESS_E;
}

QCLI_Command_Status_t cmd_set_rtt_base_delay(uint32_t Parameter_Count, QCLI_Parameter_t *Parameter_List) {
    if (Parameter_Count < 1) {
        return QCLI_STATUS_USAGE_E;
    }
    
    g_dynamic_base_delay = (uint32_t)atoi((char*)Parameter_List[0].String_Value);
    
    printf("Success: Dynamic base_delay updated to %d\n", g_dynamic_base_delay);
    
    return QCLI_STATUS_SUCCESS_E;
}

const QCLI_Command_t rtt_cmd_list[] =
{
    {cmd_RTT_Cfg,   "rtt_cfg",   "[ftms=N] [delta=N] [asap=0|1] [bw=N] [dur=N] [period=N] [cal=HEX]", "Configure RTT/FTM"},
    {cmd_RTT_Start, "rtt_start", "<mac_addr> [count]", "Start RTT/FTM measurement"},
    {cmd_RTT_Status,"rtt_status","", "Show RTT status"},
    { cmd_set_rtt_base_delay, "set_base_delay", "set_base_delay <value>", "Set RTT base delay dynamically"},
};

const QCLI_Command_Group_t rtt_cmd_group =
{
    "RTT",
    sizeof(rtt_cmd_list) / sizeof(QCLI_Command_t),
    rtt_cmd_list
};

void Initialize_RTT_Demo(void)
{
    extern void nt_rtt_register_notify_callback(void (*callback)(uint64_t));
    nt_rtt_register_notify_callback(nt_rtt_demo_notify);
    
    qcli_rtt_group = QCLI_Register_Command_Group(NULL, &rtt_cmd_group);
    if (qcli_rtt_group) {
        printf("RTT Demo Initialized.");
    } else {
        printf("RTT Demo Register FAIL!");
    }
}

void app_init(void)
{
    UART_SEND_DIRECT("app_init entry\r\n");
    // register app console commands here if have
#ifdef CONFIG_FWUP_DEMO
    Initialize_FwUpgrade_Demo();
#endif
    Initialize_Crypto_Demo();
#ifdef CONFIG_QCSPI_HFC_TEST
    extern void Initialize_qcspi_hfc_Demo(void);
    Initialize_qcspi_hfc_Demo();
#endif
#if CONFIG_MPU_DEMO
    Initialize_MPU_Demo();
#endif
#ifdef CONFIG_MGMT_FILTER_DEMO
    Initialize_Mgmt_Filter_Demo();
#endif
#if defined(CONFIG_MBEDTLS_AES_ALT) || defined(CONFIG_MBEDTLS_CCM_ALT) || defined(CONFIG_MBEDTLS_SHA_ALT)
    Initialize_Qcc_Demo();
#endif
#ifdef CONFIG_SECUREFS_DEMO
    Initialize_SecureFs_Demo();
#endif
    UART_SEND_DIRECT("app_init over\r\n");
}

extern void sht40_task_main(void *arg);

void app_main(void)
{
    UART_SEND_DIRECT("app_main entry\r\n");
    UART_SEND_DIRECT("qcli demo!\r\n");
    Initialize_RTT_Demo();

    nt_qurt_thread_create(wifi_auto_connect_task, "wifi_auto_task", 4096, NULL, 6, NULL);
    nt_qurt_thread_create(sht40_task_main, "sht40_task", 4096, NULL, 6, NULL);

    if (dead_loop) {
        UART_SEND_DIRECT("Dead loop...\r\n");
        while (dead_loop)
            ;
    }
    UART_SEND_DIRECT("app_main over\r\n");
}
```

## src/sht40_task.c
```c
/*
 * Copyright (c) 2024 Qualcomm Innovation Center, Inc. All rights reserved.
 * SPDX-License-Identifier: BSD-3-Clause-Clear
 */

#include <stdio.h>
#include <string.h>
#include <stdint.h>
#include <stdbool.h>

#include "FreeRTOS.h"
#include "task.h"

#include "qapi_i2c.h"
#include "nt_osal.h"
#include "safeAPI.h"
#include "timer.h"
#include "core_mqtt.h"
#include "plaintext_posix.h"

/* ------------------------------------------------------------------ */
/*  Configuration                                                       */
/* ------------------------------------------------------------------ */

#define SHT40_I2C_ADDR           0x44
#define SHT40_CMD_MEAS           0xFD

#define MQTT_BROKER              "139.162.181.126"
#define MQTT_PORT                1883
#define MQTT_CLIENT_ID           "sht40_qcc7030"
#define MQTT_USERNAME            "AABBCCDD"
#define MQTT_PASSWORD            "KXL8DHPsXggvRELD"
#define MQTT_TOPIC_PUB           "sensor/sht40"
#define MQTT_TOPIC_CMD           "sensor/cmd"
#define MQTT_NETWORK_BUF_SIZE    1024U
#define MQTT_KEEPALIVE_SEC       60U
#define MQTT_CONNACK_TIMEOUT_MS  5000U
#define MQTT_TRANSPORT_TIMEOUT_MS 1000U
#define MQTT_MEASURE_INTERVAL_MS 5000U
#define MQTT_PROCESS_INTERVAL_MS 500U

/* ------------------------------------------------------------------ */
/*  Shared WiFi-ready flag (owned by qcli_demo_main.c)                */
/* ------------------------------------------------------------------ */

extern volatile qbool_t g_wifi_auto_connected;

/* ------------------------------------------------------------------ */
/*  Static state                                                        */
/* ------------------------------------------------------------------ */

static PlaintextParams_t s_net_params;
static NetworkContext_t  s_net_ctx;
static MQTTContext_t     s_mqtt_ctx;
static uint8_t           s_mqtt_buf[MQTT_NETWORK_BUF_SIZE];
static volatile int      s_measure_now;

/* ------------------------------------------------------------------ */
/*  I2C / SHT40                                                        */
/* ------------------------------------------------------------------ */

static void sht40_open(void)
{
    qapi_I2CM_Config_t cfg = { .Blocking = TRUE, .Dma = FALSE };
    qapi_I2CM_Open(QAPI_I2C_INSTANCE_SE0_E, &cfg);
}

static int sht40_measure(int *temp_x10, int *rh_x10)
{
    uint8_t cmd = SHT40_CMD_MEAS;
    uint8_t rx[6];

    qapi_I2CM_Transfer_Config_t xcfg = {
        .BusFreqKHz             = 400,
        .SlaveAddress           = SHT40_I2C_ADDR,
        .SlaveMaxClockStretchUs = 0,
        .Delay                  = 0,
        .NoiseReject            = 0,
    };

    qapi_I2CM_Descriptor_t wr = {
        .Buffer      = &cmd,
        .Length      = 1,
        .Transferred = 0,
        .Flags       = QAPI_I2C_FLAG_START | QAPI_I2C_FLAG_STOP | QAPI_I2C_FLAG_WRITE,
    };
    if (qapi_I2CM_Transfer(QAPI_I2C_INSTANCE_SE0_E, &xcfg, &wr, 1, NULL, NULL) != QAPI_OK)
        return -1;

    vTaskDelay(pdMS_TO_TICKS(10));

    qapi_I2CM_Descriptor_t rd = {
        .Buffer      = rx,
        .Length      = 6,
        .Transferred = 0,
        .Flags       = QAPI_I2C_FLAG_START | QAPI_I2C_FLAG_STOP | QAPI_I2C_FLAG_READ,
    };
    if (qapi_I2CM_Transfer(QAPI_I2C_INSTANCE_SE0_E, &xcfg, &rd, 1, NULL, NULL) != QAPI_OK)
        return -1;

    uint16_t t_raw  = ((uint16_t)rx[0] << 8) | rx[1];
    uint16_t rh_raw = ((uint16_t)rx[3] << 8) | rx[4];

    *temp_x10 = -450 + (int)(1750 * (uint32_t)t_raw  / 65535);
    *rh_x10   =  -60 + (int)(1250 * (uint32_t)rh_raw / 65535);
    return 0;
}

/* ------------------------------------------------------------------ */
/*  MQTT transport / callbacks                                          */
/* ------------------------------------------------------------------ */

static uint32_t mqtt_get_time_ms(void)
{
    return hres_timer_curr_time_ms();
}

static void mqtt_event_cb(MQTTContext_t *ctx,
                          MQTTPacketInfo_t *pkt,
                          MQTTDeserializedInfo_t *info)
{
    (void)ctx;

    if ((pkt->type & 0xF0U) != MQTT_PACKET_TYPE_PUBLISH)
        return;

    MQTTPublishInfo_t *pub = info->pPublishInfo;
    if (!pub)
        return;

    /* Check topic == "sensor/cmd" */
    if (pub->topicNameLength != (sizeof(MQTT_TOPIC_CMD) - 1) ||
        strncmp(MQTT_TOPIC_CMD, pub->pTopicName, pub->topicNameLength) != 0)
        return;

    /* Check payload == "measure" */
    if (pub->payloadLength == (sizeof("measure") - 1) &&
        strncmp("measure", (const char *)pub->pPayload, pub->payloadLength) == 0)
    {
        s_measure_now = 1;
    }
}

static int mqtt_connect_and_subscribe(void)
{
    s_net_params.socketDescriptor = -1;
    s_net_ctx.pParams = &s_net_params;

    ServerInfo_t server = {
        .pHostName      = MQTT_BROKER,
        .hostNameLength = sizeof(MQTT_BROKER) - 1,
        .port           = MQTT_PORT,
    };

    if (Plaintext_Connect(&s_net_ctx, &server,
                          MQTT_TRANSPORT_TIMEOUT_MS,
                          MQTT_TRANSPORT_TIMEOUT_MS) != SOCKETS_SUCCESS)
        return -1;

    TransportInterface_t transport = {
        .pNetworkContext = &s_net_ctx,
        .send            = Plaintext_Send,
        .recv            = Plaintext_Recv,
        .writev          = NULL,
    };
    MQTTFixedBuffer_t netbuf = {
        .pBuffer = s_mqtt_buf,
        .size    = sizeof(s_mqtt_buf),
    };

    if (MQTT_Init(&s_mqtt_ctx, &transport, mqtt_get_time_ms,
                  mqtt_event_cb, &netbuf) != MQTTSuccess)
    {
        Plaintext_Disconnect(&s_net_ctx);
        return -1;
    }

    MQTTConnectInfo_t conninfo = {
        .cleanSession           = true,
        .keepAliveSeconds       = MQTT_KEEPALIVE_SEC,
        .pClientIdentifier      = MQTT_CLIENT_ID,
        .clientIdentifierLength = sizeof(MQTT_CLIENT_ID) - 1,
        .pUserName              = MQTT_USERNAME,
        .userNameLength         = sizeof(MQTT_USERNAME) - 1,
        .pPassword              = MQTT_PASSWORD,
        .passwordLength         = sizeof(MQTT_PASSWORD) - 1,
    };
    bool session_present;
    if (MQTT_Connect(&s_mqtt_ctx, &conninfo, NULL,
                     MQTT_CONNACK_TIMEOUT_MS, &session_present) != MQTTSuccess)
    {
        Plaintext_Disconnect(&s_net_ctx);
        return -1;
    }

    MQTTSubscribeInfo_t sub = {
        .qos              = MQTTQoS0,
        .pTopicFilter     = MQTT_TOPIC_CMD,
        .topicFilterLength = sizeof(MQTT_TOPIC_CMD) - 1,
    };
    uint16_t sub_id = MQTT_GetPacketId(&s_mqtt_ctx);
    if (MQTT_Subscribe(&s_mqtt_ctx, &sub, 1, sub_id) != MQTTSuccess)
    {
        Plaintext_Disconnect(&s_net_ctx);
        return -1;
    }

    /* Consume SUBACK */
    MQTT_ProcessLoop(&s_mqtt_ctx);

    printf("MQTT: connected to %s:%d, subscribed to %s\r\n",
           MQTT_BROKER, MQTT_PORT, MQTT_TOPIC_CMD);
    return 0;
}

static int mqtt_publish(int temp_x10, int rh_x10)
{
    char msg[48];
    int len = snprintf(msg, sizeof(msg), "Temp=%d.%dC Feuchte=%d.%d%%",
                       temp_x10 / 10, temp_x10 % 10,
                       rh_x10  / 10, rh_x10  % 10);
    if (len <= 0 || len >= (int)sizeof(msg))
        return -1;

    MQTTPublishInfo_t pub = {
        .qos             = MQTTQoS0,
        .retain          = false,
        .dup             = false,
        .pTopicName      = MQTT_TOPIC_PUB,
        .topicNameLength = sizeof(MQTT_TOPIC_PUB) - 1,
        .pPayload        = msg,
        .payloadLength   = (size_t)len,
    };
    return MQTT_Publish(&s_mqtt_ctx, &pub, 0) == MQTTSuccess ? 0 : -1;
}

/* ------------------------------------------------------------------ */
/*  Task entry                                                          */
/* ------------------------------------------------------------------ */

void sht40_task_main(void *arg)
{
    (void)arg;

    sht40_open();

    /* Wait for WiFi association */
    while (!g_wifi_auto_connected)
        vTaskDelay(pdMS_TO_TICKS(500));

    /* Give DHCP time to complete after WiFi link is up */
    vTaskDelay(pdMS_TO_TICKS(3000));

    for (;;) {
        printf("MQTT: connecting to %s:%d...\r\n", MQTT_BROKER, MQTT_PORT);
        while (mqtt_connect_and_subscribe() != 0) {
            printf("MQTT: connect failed, retry in 5s\r\n");
            vTaskDelay(pdMS_TO_TICKS(5000));
        }

        TickType_t last_pub = xTaskGetTickCount();
        s_measure_now = 0;

        /* Process loop: run every 500ms, publish every 5s or on demand */
        for (;;) {
            MQTTStatus_t st = MQTT_ProcessLoop(&s_mqtt_ctx);
            if (st != MQTTSuccess && st != MQTTNeedMoreBytes) {
                printf("MQTT: session lost (%d), reconnecting\r\n", (int)st);
                Plaintext_Disconnect(&s_net_ctx);
                break;
            }

            TickType_t now   = xTaskGetTickCount();
            uint32_t elapsed = (uint32_t)((now - last_pub) * portTICK_PERIOD_MS);
            int do_measure   = s_measure_now || (elapsed >= MQTT_MEASURE_INTERVAL_MS);

            if (do_measure) {
                int temp_x10 = 0, rh_x10 = 0;
                if (sht40_measure(&temp_x10, &rh_x10) == 0) {
                    printf("Temp=%d.%dC Feuchte=%d.%d%%\r\n",
                           temp_x10 / 10, temp_x10 % 10,
                           rh_x10  / 10, rh_x10  % 10);
                    if (mqtt_publish(temp_x10, rh_x10) != 0) {
                        printf("MQTT: publish failed, reconnecting\r\n");
                        Plaintext_Disconnect(&s_net_ctx);
                        s_measure_now = 0;
                        break;
                    }
                }
                last_pub      = xTaskGetTickCount();
                s_measure_now = 0;
            }

            vTaskDelay(pdMS_TO_TICKS(MQTT_PROCESS_INTERVAL_MS));
        }

        /* Brief pause before reconnect */
        vTaskDelay(pdMS_TO_TICKS(3000));
    }
}
```
