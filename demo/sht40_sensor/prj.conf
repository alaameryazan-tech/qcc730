## prj.conf
```kconfig
# qcc730 demo setting

CONFIG_NET_SHELL=y

CONFIG_LOWPOWER_SHELL=y

CONFIG_PLATFORM_SHELL=y

CONFIG_QCCSDK_DEMO=y

CONFIG_WLAN_QAPI=y

CONFIG_MQTT_CLIENT=y

#CONFIG_FILE_SYSTEM=y

#CONFIG_FILE_SYSTEM_LITTLEFS=y

#CONFIG_POSIX_FS_API=y

CONFIG_FW_UPGRADE=y

CONFIG_RING_IF_ONLY=n

CONFIG_QCCSDK_CONSOLE=y

CONFIG_WIFI_SHELL=y

CONFIG_FREERTOS_PLUS_POSIX=y

#CONFIG_QCSPI_HFC_TEST=y

# Transport layer mode of MQTT, Choose one of the following three modes

#CONFIG_MQTT_PLAINTEXT_DEMO=y

#CONFIG_MQTT_BASIC_TLS_DEMO=n

#CONFIG_MQTT_MUTUAL_AUTH_DEMO=n

# end of mqtt demo setting
```

## src/powertest_demo_main.c
```c
/*
 * Copyright (c) 2024 Qualcomm Innovation Center, Inc. All rights reserved.
 * SPDX-License-Identifier: BSD-3-Clause-Clear
 */

#include <stdio.h>
#include <string.h>
#include <stdint.h>

#ifdef FERMION_SILICON
extern uint32_t UART_Send_direct(char *txbuf, uint32_t buflen);
#define UART_SEND_DIRECT(str) UART_Send_direct((str), strlen(str))
#else
#define UART_SEND_DIRECT(str)
#endif

void app_init(void)
{
    UART_SEND_DIRECT("app_init entry\r\n");
    Initialize_powertest_Demo();
    UART_SEND_DIRECT("app_init over\r\n");
}

void app_main(void)
{
    UART_SEND_DIRECT("app_main entry\r\n");

    UART_SEND_DIRECT("app_main over\r\n");
}
```
