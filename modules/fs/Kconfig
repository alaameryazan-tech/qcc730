## modules/fs/Kconfig
```kconfig
#Copyright (c) 2024 Qualcomm Innovation Center, Inc. All rights reserved.
#SPDX-License-Identifier: BSD-3-Clause-Clear
config FILE_SYSTEM
	bool "FS support"
        depends on BOARD_QCC730_QSPI_ENABLE
	help
	  Enables file system support.

if FILE_SYSTEM

menu "FS Settings"

config FILE_SYSTEM_MAX_TYPES
    int
    default 1

config  MAX_DIRECTORY_DEPTH
    int "max directory depth"
    range 1 2
    default 2
rsource "Kconfig.lfs"
rsource "Kconfig.posix_fs"

config FS_SHELL
    bool "FS Command Shell"
    default n

config SECUREFS_DEMO
    bool "enable secure storage demo"
    default n

endmenu

endif # FILE_SYSTEM
```

## modules/fs/Kconfig.lfs
```kconfig
#Copyright (c) 2024 Qualcomm Innovation Center, Inc. All rights reserved.
#SPDX-License-Identifier: BSD-3-Clause-Clear
config FILE_SYSTEM_LITTLEFS
        depends on FILE_SYSTEM
	bool "LittleFS support"
	help
	  Enables LittleFS file system support.

if FILE_SYSTEM_LITTLEFS

menu "LittleFS Settings"

config FS_LITTLEFS_READ_SIZE
	int "Minimum size of a block read"
	default 16

config FS_LITTLEFS_PROG_SIZE
	int "Minimum size of a block program"
	default 16

config FS_LITTLEFS_CACHE_SIZE
	int "Size of block caches in bytes"
	default 64

config FS_LITTLEFS_LOOKAHEAD_SIZE
	int "Size of lookahead buffer in bytes"
	default 32

config FS_LITTLEFS_BLOCK_CYCLES
	int "Number of erase cycles before moving data to another block"
	default 512

config FS_LITTLEFS_BLOCK_SIZE
	int
	default 4096

config FS_LITTLEFS_NUM_FILES
        int
        default 4
config FS_LITTLEFS_NUM_DIRS
        int
        default 4

endmenu

endif # FILE_SYSTEM_LITTLEFS
```

## modules/fs/Kconfig.posix_fs
```kconfig
#Copyright (c) 2024 Qualcomm Innovation Center, Inc. All rights reserved.
#SPDX-License-Identifier: BSD-3-Clause-Clear
config POSIX_FS_API
        depends on FILE_SYSTEM
	bool "POSIX FS API support"
config POSIX_MAX_FDS
        int
        default 4
config POSIX_MAX_OPEN_FILES
        int
        default 4
```

## modules/fw_upgrade/Kconfig
```kconfig
menu "fwupgrade setting"
config FW_UPGRADE
    bool "FW_UPGRADE enable"
    default n
    depends on BOARD_QCC730_QSPI_ENABLE
    help
        enable Fwupgrade
        
config FW_UPGRADE_FWD_SUPPORT_NUM
    int "supported fw upgrade fwd numbers"
    depends on FW_UPGRADE
    default 2
    range 2 3

config FW_UPGRADE_NO_FS
    bool "FW UPGRADE do not support FS"
    depends on FW_UPGRADE
    default n
    help
        enable Fw upgrade fs
endmenu
```

## modules/net/httpc/Kconfig
```kconfig
config HTTP_CLIENT
    bool "enable HTTP client"
    default n

config HTTP_CLIENT_DEMO
    depends on HTTP_CLIENT && FILE_SYSTEM
    bool "enable HTTP client demo"
    default n
```

## modules/net/httpd/Kconfig
```kconfig
config HTTP_SERVER
    bool "enable HTTP server"
    default n

config HTTP_SERVER_DEMO
    bool "enable HTTP server demo"
    default n
```

## modules/net/mbedtls/Kconfig
```kconfig
menu "mbedTLS setting"
config MBEDTLS_USE_PKA
    bool "enable PKA for MbedTLS"
    default y

config MBEDTLS_PKA_TEST
    bool "enable test for Mbedtls PKA"
    depends on MBEDTLS_USE_PKA
    default y
config MBEDTLS_AES_ALT
    bool "enable aes alt"
    default n
config MBEDTLS_CCM_ALT
    bool "enable ccm alt"
    depends on MBEDTLS_AES_ALT
    default n
config MBEDTLS_SHA_ALT
    bool "enable sha1 sha256 alt"
    default n
endmenu
```

## modules/net/mqtt_client/Kconfig
```kconfig
config MQTT_CLIENT
    bool "enable MQTT client"
    default n

config MQTT_CLIENT_DEMO
    depends on MQTT_CLIENT && FILE_SYSTEM
    bool "enable MQTT client demo"
    default n

config MQTT_PLAINTEXT_DEMO
    depends on MQTT_CLIENT && FILE_SYSTEM
    bool "enable MQTT over TCP demo"
    default n

config MQTT_BASIC_TLS_DEMO
    depends on MQTT_CLIENT && FILE_SYSTEM
    bool "enable MQTT over SSL one way authentication demo"
    default n

config MQTT_MUTUAL_AUTH_DEMO
    depends on MQTT_CLIENT && FILE_SYSTEM
    bool "enable MQTT over SSL mutual authentication demo"
    default n
```

## modules/net/sntp/Kconfig
```kconfig
config SNTP_CLIENT
    bool "enable SNTP client"
    default n

config SNTP_CLIENT_DEMO
    depends on SNTP_CLIENT
    bool "enable SNTP client demo"
    default n
```

## modules/qat/Kconfig
```kconfig
menu "qat setting"
config QAT
    bool "enable QAT"
    default n
config QAT_COMMON_DEMO
    bool "enable QAT COMMON DEMO"
    default n
config QAT_TRANSMISSION_MODULE
    int "change transmission module for QAT. 0:UART, 1:SPI"
    default 0
config QAT_TCPIP_DEMO
    bool "enable QAT TCPIP DEMO"
    default n
config QAT_WLAN_DEMO
    bool "enable QAT WLAN DEMO"
    default n
config QAT_MQTT_DEMO
    bool "enable QAT MQTT DEMO"
    default n
config QAT_HTTP_SERVER_DEMO
    bool "enable QAT HTTP_SERVER DEMO"
    default n
config QAT_HTTPC_DEMO
    bool "enable QAT HTTPC DEMO"
    default n
config QAT_OTA_DEMO
    bool "enable QAT OTA DEMO"
    default n
config QAT_FSTORE_DEMO
    bool "enable QAT FSTORE DEMO (AT+WRITEFILE/READFILE/DELFILE)"
    default n
config QAT_POWERSAVE_DEMO
    bool "enable QAT POWERSAVE DEMO"
    default n
config QAT_CB_SIZE_MTU_MULTIPLIER
    int "Set the circular buffer size to be a multiple of the MTU."
    default 10

config QAT_CB_QUEUE_MAX_LENGTH
    int "set max length of the circular buffer queue"
    default 10
endmenu
```

## modules/supplicant/Kconfig
```kconfig
# Copyright (c) Qualcomm Technologies, Inc. and/or its subsidiaries.
# SPDX-License-Identifier: BSD-3-Clause-Clear

menu "supplicant sub modules Settings"

config ENABLE_SUPPLICANT
    bool "Enable WPA Supplicant"
    default n

config NO_STDOUT_DEBUG
    bool "disable wpa debug"
    default n

config WLAN_8021X
    bool "enable wlan 8021x"
    default n

endmenu
```

## modules/wifi/Kconfig
```kconfig
menu "WiFi setting"
rsource "Kconfig.rtt"
rsource "Kconfig.wapp"
rsource "Kconfig.lib"

menu "System Setting"
config PBL_PREES_GPIO_RESTORE
	bool "Restore GPIO to reset state, so to fix pre-ES PBL wrong operation on GPIO. If ioe_PBL released, please default to n"
	default y

config PBL_PREES_RESET_FOR_DTIM
	bool "A reset with CFG_FORCE_NPS_PD_ON is needed for Sleep function. If ioe_PBL released, please default to n"
	default n

config RING_IF_ONLY
        bool "Enable RingIF for hosted mode. if hostless mode, please default to n"
        default n

config QCSPI_HFC_TEST 
        bool "Enable QCSPI Slave HFC test demo. if QCSPI HFC test demo is not needed , please default to n"
        default n

config QCSPI_HFC_ATCMD_ENABLE 
        bool "Enable AT command over QCSPI. if AT Command over QCSPI is not needed , please default to n"
        default n

config ENABLE_P2P_MODE
	bool "P2p mode. Please default to n"
	default n

config ENABLE_P2P_LIB
    bool "enable p2p lib support"
    default n

endmenu
endmenu
```

## modules/wifi/Kconfig.rtt
```kconfig
menu "rtt setting"
config NT_DEVCFG_LOCATION_TYPE
    int "location_type"
    default 1
    range 0 2
config NT_DEVCFG_LOCATION
    int "location"
    default 0
    range 0 1
config NT_DEVCFG_FTM_MODE
    int "ftm_mode"
    default 1

config NT_DEVCFG_ASAP
    int "asap"
    default 1

config NT_DEVCFG_FTM_PER_BURST
    int "ftms_per_burst"
    default 2

config NT_DEVCFG_NO_OF_BUR_EXP
    int "no_of_bur_exp"
    default 2

config NT_DEVCFG_FTM_MIN_DELTA_RESP
    int "delta time btw two sucessive ftm frames in 100us uints"
    default 1

config NT_DEVCFG_FTM_BURST_DURATION_RESP
    int "code value of burst duration" 
    default 10

config NT_DEVCFG_FTM_BURST_PERIOD_RESP
    int "burst period value in 100ms uints"
    default 40

config NT_DEVCFG_FORMAT_AND_BANDWIDTH
    int "code value for format and bandwidth TABLE 9-257"
    default 0

config NT_DEVCFG_PARTIAL_TSF_TIME_OFFSET_RESP
    int "DTSF value in ms"
    default 5

config NT_DEVCFG_PARTIAL_TSF_TIMER_NO_PREFERENCE_INITIATOR
    int "indicates the preference of partial TSF field value- 1(not prefered)"
    default 1

config NT_DEVCFG_FTM_MIN_DELTA_INITIATOR
    int "delta time btw two sucessive frames"
    default 0

config NT_DEVCFG_FTM_BURST_DURATION_INITIATOR
    int "code value of burst duration at the initiator"
    default 15

config NT_DEVCFG_FTM_BURST_PERIOD_INITIATOR
    int "burst period value in 100ms uints at the initiator"
    default 0

endmenu
```

## modules/wifi/Kconfig.wapp
```kconfig
menu "wapp setting"
config NT_DEVCFG_WIFI_ON_ENABLE
    int "enables and disable the wifi on command at boot time"
    range 0 1
    default 0
config NT_DEVCFG_XPA_ENABLE
    int "enables and disables the external PA"
    range 0 1
    default 0
endmenu
```

## soc/qcc730/Kconfig.peripherals
```kconfig
#################################################################
#SOC capacity
config SOC_QCC730_HAS_UART_V1
	bool "SOC QCC730 HAS UART V1, only GPIO_11/12"
	default n

config SOC_QCC730_HAS_UART_V2
	bool "SOC QCC730 HAS UART V2, has 4 options as BOARD_QCC730_UART_GPIO_OPTION"
	default n

config SOC_QCC730_HAS_XPA_AUTO_CTRL
	bool "SOC QCC730 HAS XPA AUTO CTRL"
	default n

config SOC_QCC730_HAS_BT_COEX
	bool "SOC QCC730 HAS BT COEX"
	default n

config SOC_QCC730_HAS_I2C
	bool "SOC QCC730 HAS I2C"
	default n

config SOC_QCC730_HAS_QSPI_V1
	bool "SOC QCC730 HAS QSPI V1, only support 2 BITS"
	default n

config SOC_QCC730_HAS_QSPI_V2
	bool "SOC QCC730 HAS QSPI V2, support 2/4 BITS"
	default n

config SOC_QCC730_HAS_SPI_SLAVE
	bool "SOC QCC730 HAS SPI SLAVE"
	default n

#################################################################
#boards capable configuration

config BOARD_QCC730_I2C_ENABLE
	bool "BOARD QCC730 I2C ENABLE"
	depends on SOC_QCC730_HAS_I2C
	default n

config BOARD_QCC730_BT_COEX_ENABLE
	bool "BOARD QCC730 BT COEX ENABLE"
	depends on SOC_QCC730_HAS_BT_COEX
	default n

config BOARD_QCC730_BT_COEX_MODE
	int "BOARD QCC730 BT COEX MODE"
	range 0 3
	depends on BOARD_QCC730_BT_COEX_ENABLE
	default 0

config BOARD_QCC730_QSPI_ENABLE
	bool "BOARD QCC730 QSPI ENABLE"
	depends on SOC_QCC730_HAS_QSPI_V1 || SOC_QCC730_HAS_QSPI_V2
	default n

config BOARD_QCC730_QSPI_V1_OPTION
	int "BOARD QCC730 QSPI V1 option. 0: GPIO_4/5/6/7; 1: GPIO_4/11/12/14"
	depends on BOARD_QCC730_QSPI_ENABLE && SOC_QCC730_HAS_QSPI_V1
	range 0 1
	default 0

config BOARD_QCC730_QSPI_V2_QUAD_MODE
	int "BOARD QCC730 QSPI V2 QUAD mode. 0: only QSPI 2 bits on GPIO_4/5/6/7; 1: QSPI 4 bits on GPIO_4/5/6/7/11/12"
	depends on BOARD_QCC730_QSPI_ENABLE && SOC_QCC730_HAS_QSPI_V2
	range 0 1
	default 1

config BOARD_QCC730_XPA_AUTO_CTRL_ENABLE
	bool "BOARD QCC730 XPA auto ctrl enable"
	depends on SOC_QCC730_HAS_XPA_AUTO_CTRL
	default n

config BOARD_QCC730_XPA_AUTO_CTRL_GPIO_OPTION
	int "BOARD QCC730 XPA GPIO options. 0: GPIO_7/6; 1: GPIO_0/2"
	range 0 1
	depends on BOARD_QCC730_XPA_AUTO_CTRL_ENABLE
	default 0

config BOARD_QCC730_UART_ENABLE
	bool "BOARD QCC730 uart enable"
	depends on SOC_QCC730_HAS_UART_V1 || SOC_QCC730_HAS_UART_V2
	default n

config BOARD_QCC730_UART_GPIO_OPTION
	int "BOARD QCC730 UART GPIO options. 0: GPIO_11/12; 1: GPIO_13/14; 2: GPIO_9/10; 3: GPIO_1/3"
	range 0 3
	depends on BOARD_QCC730_UART_ENABLE && SOC_QCC730_HAS_UART_V2
	default 0

config BOARD_QCC730_SPI_SLAVE_ENABLE
	bool "BOARD QCC730 SPI slave enable"
	depends on SOC_QCC730_HAS_SPI_SLAVE
	default n

config BOARD_QCC730_SPI_SLAVE_OPTION
	int "BOARD QCC730 SPI SLAVE options. 0: DWSPI; 1: QCSPI"
	range 0 1
	depends on BOARD_QCC730_SPI_SLAVE_ENABLE
	default 0

config BOARD_QCC730_GPIO_DEFAULT_PU_STATE
    hex "GPIO internal default pull up state"
    default 0xABB0A if BOARD_QCC730_UART_GPIO_OPTION = 0
    default 0xAEB0A if BOARD_QCC730_UART_GPIO_OPTION = 1
    default 0xAAF0A if BOARD_QCC730_UART_GPIO_OPTION = 2
    default 0xAAB0A if BOARD_QCC730_UART_GPIO_OPTION = 3

config BOARD_QCC730_GPIO_DEFAULT_PD_STATE
    hex "GPIO internal default pull down state"
    default 0x1544D0 if BOARD_QCC730_UART_GPIO_OPTION = 0
    default 0x1514F0 if BOARD_QCC730_UART_GPIO_OPTION = 1
    default 0x1550F0 if BOARD_QCC730_UART_GPIO_OPTION = 2
    default 0x1554F0 if BOARD_QCC730_UART_GPIO_OPTION = 3
```
