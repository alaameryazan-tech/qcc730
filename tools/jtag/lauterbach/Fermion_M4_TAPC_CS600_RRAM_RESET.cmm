&scripts=OS.ENV("FERMION_SCRIPTS_DIR")
cd &scripts

area

SYStem.RESetOut

; PMU_SYS_SOFT_RESET_REQ
do JTAG2AHB_WRITE.cmm 0x11AEC3C 0x1

WAIT 15000.MS


 
; Lock JTAG port and enable debug cable
JTAG.LOCK
JTAG.PIN ENable
; release System Reset and reset TAP Controller
JTAG.PIN NRESET HIGH
JTAG.PIN NTRST LOW
WAIT 50.MS ; wait until reset is active
JTAG.PIN NTRST HIGH
WAIT 50.MS ; wait until reset is released


; move from “Run-Test/ Idle“ to "Shift-IR" state
JTAG.SHIFTTMS 0 0 0 1 1 0 0

; 7 Bit "Shift-IR" value 0x0B, switch to "Exit1-IR" on last bit
JTAG.SHIFTREG 1 1 0 1 0 0 0

; move to “Run-Test/ Idle“ from "Exit1-IR" state
JTAG.SHIFTTMS 1 0

; release JTAG port
JTAG.PIN TMS 0 ; Pull TMS pin to 0
JTAG.PIN TDI 0 ; Pull TDI pin to 0
JTAG.UNLOCK


; Manual config
SYS.CPU CortexM4F 
SYS.Option EnReset OFF 
SYS.Option TRST OFF 
;SYS.jtagclock CTCK 100KHz 
;SYS.jtagclock CTCK 1MHz
SYS.jtagclock CTCK 15MHz
SYS.CONFIG.AHBAP1.Base DP:0x40000
SYS.MEMACCESS AHB

SYS.Attach 
Break

;d.dump 0x001A0FB0--0x001A0FFF
d.dump 0x0000--0x001FF

 



