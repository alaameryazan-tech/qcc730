&scripts=OS.ENV("FERMION_SCRIPTS_DIR")
cd &scripts

area.CREATE A000, 500
area.VIEW A000
area.OPEN A000 PMU_REG_READ_LOG.txt ;; Opening a file to save the full register-read log

; Set the BOOT complete to 
; [0]   power up PMIC
; [1]   power up XO_DTOP
; [2]   power up RFA_DTOP
; [3]   power up SON
; [5:4] power up MEM_NORMAL(01) RETTAINED(10) OFF (00)
; [6]   power up CSS
; [7]   Boot from CMEMA
; [8]   Boot from CMEMB
; [9]   Boot from CMEMC
; [10]  Boot from CMEMD
; [11]  Boot from RRAM
; [22]  Boot from CMEME
do JTAG2AHB_WRITE.cmm 0x011af854 0x0DF

; Boot code download complete
do JTAG2AHB_WRITE.cmm 0x011af404 0x800000

; 32bit Write RRAM legacy mode
do JTAG2AHB_WRITE.cmm 0x011af81C 0x84002080


; PBL_WRITTEN_KDF_XIP_STICKY_DISABLE_PROT
do JTAG2AHB_WRITE.cmm 0x011afbb0 0x80000000



;;;;;;;;;;;;;;;;;;;;;;;;;;;;;;;;;;;;;;;;;;;;;;;;;;;;;;;;;;;;;;;;;;;;;;
; Reading PMU registers using 'Fermion_JTAG2AHB_READ_TDI.cmm'

;PRINTF "REG_NAME"


PRINTF "Reading PMU registers..."
;;;
 PRINTF "A_PMU_TOP_BCR                             " 
do Fermion_JTAG2AHB_READ_TDI.cmm (0x011AEC00)
 PRINTF "A_PMU_COMMON_BCR                          " 
do Fermion_JTAG2AHB_READ_TDI.cmm (0x011AEC04)
 PRINTF "A_PMU_CMEM_BANK_A_BCR                     " 
do Fermion_JTAG2AHB_READ_TDI.cmm (0x011AEC08)
 PRINTF "A_PMU_CMEM_BANK_B_BCR                     " 
do Fermion_JTAG2AHB_READ_TDI.cmm (0x011AEC0C)
 PRINTF "A_PMU_CMEM_BANK_C_BCR                     " 
do Fermion_JTAG2AHB_READ_TDI.cmm (0x011AEC10)
 PRINTF "A_PMU_CMEM_BANK_D_BCR                     " 
do Fermion_JTAG2AHB_READ_TDI.cmm (0x011AEC14)
 PRINTF "A_PMU_WLAN_MAC_BCR                        " 
do Fermion_JTAG2AHB_READ_TDI.cmm (0x011AEC18)
 PRINTF "A_PMU_WLAN_PHY_TX_BCR                     " 
do Fermion_JTAG2AHB_READ_TDI.cmm (0x011AEC1C)
 PRINTF "A_PMU_WLAN_PHY_RXA_BCR                    " 
do Fermion_JTAG2AHB_READ_TDI.cmm (0x011AEC20)
 PRINTF "A_PMU_WLAN_PHY_RXTOP_BCR                  " 
do Fermion_JTAG2AHB_READ_TDI.cmm (0x011AEC24)
 PRINTF "A_PMU_SIF_BCR                             " 
do Fermion_JTAG2AHB_READ_TDI.cmm (0x011AEC28)
 PRINTF "A_PMU_QSPI_BCR                            " 
do Fermion_JTAG2AHB_READ_TDI.cmm (0x011AEC2C)
 PRINTF "A_PMU_XIP_BCR                             " 
do Fermion_JTAG2AHB_READ_TDI.cmm (0x011AEC30)
 PRINTF "A_PMU_SECIP_BCR                           " 
do Fermion_JTAG2AHB_READ_TDI.cmm (0x011AEC34)
 PRINTF "A_PMU_WUR_BCR                             " 
do Fermion_JTAG2AHB_READ_TDI.cmm (0x011AEC38)
 PRINTF "A_PMU_SYS_SOFT_RESET_REQ                  " 
do Fermion_JTAG2AHB_READ_TDI.cmm (0x011AEC3C)
 PRINTF "A_PMU_PSS_BCR                             " 
do Fermion_JTAG2AHB_READ_TDI.cmm (0x011AEC40)
 PRINTF "A_PMU_CXC_BCR                             " 
do Fermion_JTAG2AHB_READ_TDI.cmm (0x011AEC44)
 PRINTF "A_PMU_CMEM_BANK_E_BCR                     " 
do Fermion_JTAG2AHB_READ_TDI.cmm (0x011AEC48)
 PRINTF "A_PMU_TOP_AHB_CBCR                        " 
do Fermion_JTAG2AHB_READ_TDI.cmm (0x011AEC50)
 PRINTF "A_PMU_TOP_SLP_CBCR                        " 
do Fermion_JTAG2AHB_READ_TDI.cmm (0x011AEC54)
 PRINTF "A_PMU_TOP_XO_CBCR                         " 
do Fermion_JTAG2AHB_READ_TDI.cmm (0x011AEC58)
 PRINTF "A_PMU_COMMON_AHB_CBCR                     " 
do Fermion_JTAG2AHB_READ_TDI.cmm (0x011AEC5C)
 PRINTF "A_PMU_COMMON_CMEM_BANK_A_CBCR             " 
do Fermion_JTAG2AHB_READ_TDI.cmm (0x011AEC60)
 PRINTF "A_PMU_COMMON_CMEM_BANK_B_CBCR             " 
do Fermion_JTAG2AHB_READ_TDI.cmm (0x011AEC64)
 PRINTF "A_PMU_COMMON_CMEM_BANK_C_CBCR             " 
do Fermion_JTAG2AHB_READ_TDI.cmm (0x011AEC68)
 PRINTF "A_PMU_COMMON_CMEM_BANK_D_CBCR             " 
do Fermion_JTAG2AHB_READ_TDI.cmm (0x011AEC6C)
 PRINTF "A_PMU_WLAN_MAC_CBCR                       " 
do Fermion_JTAG2AHB_READ_TDI.cmm (0x011AEC70)
 PRINTF "A_PMU_WLAN_PHY_RXFAST_CBCR                " 
do Fermion_JTAG2AHB_READ_TDI.cmm (0x011AEC74)
 PRINTF "A_PMU_WLAN_PHY_TX_CBCR                    " 
do Fermion_JTAG2AHB_READ_TDI.cmm (0x011AEC78)
 PRINTF "A_PMU_WLAN_PHY_TXTOP_CBCR                 " 
do Fermion_JTAG2AHB_READ_TDI.cmm (0x011AEC7C)
 PRINTF "A_PMU_WLAN_PHY_TX_ADC_CBCR                " 
do Fermion_JTAG2AHB_READ_TDI.cmm (0x011AEC80)
 PRINTF "A_PMU_WLAN_PHY_TXB_CBCR                   " 
do Fermion_JTAG2AHB_READ_TDI.cmm (0x011AEC84)
 PRINTF "A_PMU_WLAN_PHY_TX_RXTOPCLK_CBCR           " 
do Fermion_JTAG2AHB_READ_TDI.cmm (0x011AEC88)
 PRINTF "A_PMU_WLAN_PHY_RXTOP_CBCR                 " 
do Fermion_JTAG2AHB_READ_TDI.cmm (0x011AEC8C)
 PRINTF "A_PMU_WLAN_PHY_RXTOP_ADC_CBCR             " 
do Fermion_JTAG2AHB_READ_TDI.cmm (0x011AEC90)
 PRINTF "A_PMU_WLAN_PHY_DBG_CBCR                   " 
do Fermion_JTAG2AHB_READ_TDI.cmm (0x011AEC94)
 PRINTF "A_PMU_WLAN_MAC_PHY_TXCLK_CBCR             " 
do Fermion_JTAG2AHB_READ_TDI.cmm (0x011AEC98)
 PRINTF "A_PMU_WLAN_PHY_RXA_RXTOPCLK_CBCR          " 
do Fermion_JTAG2AHB_READ_TDI.cmm (0x011AEC9C)
 PRINTF "A_PMU_WLAN_PHY_RXTOP_TXCLK_CBCR           " 
do Fermion_JTAG2AHB_READ_TDI.cmm (0x011AECA0)
 PRINTF "A_PMU_SIF_AHB_CBCR                        " 
do Fermion_JTAG2AHB_READ_TDI.cmm (0x011AECA4)
 PRINTF "A_PMU_SIF_SDIOC_CBCR                      " 
do Fermion_JTAG2AHB_READ_TDI.cmm (0x011AECA8)
 PRINTF "A_PMU_SIF_SLP_CBCR                        " 
do Fermion_JTAG2AHB_READ_TDI.cmm (0x011AECAC)
 PRINTF "A_PMU_COMMON_QSPI_HCLK_CBCR               " 
do Fermion_JTAG2AHB_READ_TDI.cmm (0x011AECB0)
 PRINTF "A_PMU_COMMON_QSPI_REF_CBCR                " 
do Fermion_JTAG2AHB_READ_TDI.cmm (0x011AECB4)
 PRINTF "A_PMU_COMMON_XIP_CBCR                     " 
do Fermion_JTAG2AHB_READ_TDI.cmm (0x011AECB8)
 PRINTF "A_PMU_WUR_ADC_CBCR                        " 
do Fermion_JTAG2AHB_READ_TDI.cmm (0x011AECBC)
 PRINTF "A_PMU_WUR_CORE_CBCR                       " 
do Fermion_JTAG2AHB_READ_TDI.cmm (0x011AECC0)
 PRINTF "A_PMU_WUR_AHB_CBCR                        " 
do Fermion_JTAG2AHB_READ_TDI.cmm (0x011AECC4)
 PRINTF "A_PMU_WUR_12M_CBCR                        " 
do Fermion_JTAG2AHB_READ_TDI.cmm (0x011AECC8)
 PRINTF "A_PMU_COMMON_SECIP_CBCR                   " 
do Fermion_JTAG2AHB_READ_TDI.cmm (0x011AECCC)
 PRINTF "A_PMU_PSS_AHB_APB_CORE_CBCR               " 
do Fermion_JTAG2AHB_READ_TDI.cmm (0x011AECD0)
 PRINTF "A_PMU_WLAN_MAC_CORE_CBCR                  " 
do Fermion_JTAG2AHB_READ_TDI.cmm (0x011AECD4)
 PRINTF "A_PMU_COMMON_XO_CBCR                      " 
do Fermion_JTAG2AHB_READ_TDI.cmm (0x011AECD8)
 PRINTF "A_PMU_CXC_CORE_CBCR                       " 
do Fermion_JTAG2AHB_READ_TDI.cmm (0x011AECDC)
 PRINTF "A_PMU_COMMON_CMEM_BANK_E_CBCR             " 
do Fermion_JTAG2AHB_READ_TDI.cmm (0x011AECE0)
 PRINTF "A_PMU_AON_XO_CLK_DIV_BY_4_CBCR            " 
do Fermion_JTAG2AHB_READ_TDI.cmm (0x011AECE4)
 PRINTF "A_PMU_COMMON_GDSCR                        " 
do Fermion_JTAG2AHB_READ_TDI.cmm (0x011AECF0)
 PRINTF "A_PMU_CMEM_BANK_A_GDSCR                   " 
do Fermion_JTAG2AHB_READ_TDI.cmm (0x011AECF4)
 PRINTF "A_PMU_CMEM_BANK_B_GDSCR                   " 
do Fermion_JTAG2AHB_READ_TDI.cmm (0x011AECF8)
 PRINTF "A_PMU_CMEM_BANK_C_GDSCR                   " 
do Fermion_JTAG2AHB_READ_TDI.cmm (0x011AECFC)
 PRINTF "A_PMU_CMEM_BANK_D_GDSCR                   " 
do Fermion_JTAG2AHB_READ_TDI.cmm (0x011AED00)
 PRINTF "A_PMU_WLAN_MAC_GDSCR                      " 
do Fermion_JTAG2AHB_READ_TDI.cmm (0x011AED04)
 PRINTF "A_PMU_WLAN_PHY_TX_GDSCR                   " 
do Fermion_JTAG2AHB_READ_TDI.cmm (0x011AED08)
 PRINTF "A_PMU_WLAN_PHY_RXA_GDSCR                  " 
do Fermion_JTAG2AHB_READ_TDI.cmm (0x011AED0C)
 PRINTF "A_PMU_WLAN_PHY_RXTOP_GDSCR                " 
do Fermion_JTAG2AHB_READ_TDI.cmm (0x011AED10)
 PRINTF "A_PMU_XIP_GDSCR                           " 
do Fermion_JTAG2AHB_READ_TDI.cmm (0x011AED14)
 PRINTF "A_PMU_SECIP_GDSCR                         " 
do Fermion_JTAG2AHB_READ_TDI.cmm (0x011AED18)
 PRINTF "A_PMU_QSPI_GDSCR                          " 
do Fermion_JTAG2AHB_READ_TDI.cmm (0x011AED1C)
 PRINTF "A_PMU_SIF_GDSCR                           " 
do Fermion_JTAG2AHB_READ_TDI.cmm (0x011AED20)
 PRINTF "A_PMU_WUR_GDSCR                           " 
do Fermion_JTAG2AHB_READ_TDI.cmm (0x011AED24)
 PRINTF "A_PMU_PSS_GDSCR                           " 
do Fermion_JTAG2AHB_READ_TDI.cmm (0x011AED28)
 PRINTF "A_PMU_CXC_GDSCR                           " 
do Fermion_JTAG2AHB_READ_TDI.cmm (0x011AED2C)
 PRINTF "A_PMU_CMEM_BANK_E_GDSCR                   " 
do Fermion_JTAG2AHB_READ_TDI.cmm (0x011AED30)
 PRINTF "A_PMU_TOP_SIF_AHB_CLK_CMD_RCGR            " 
do Fermion_JTAG2AHB_READ_TDI.cmm (0x011AED40)
 PRINTF "A_PMU_TOP_SIF_AHB_CLK_CFG_RCGR            " 
do Fermion_JTAG2AHB_READ_TDI.cmm (0x011AED44)
 PRINTF "A_PMU_WLAN_PHY_TXRFIF_RXB_CLK_CMD_RCGR    " 
do Fermion_JTAG2AHB_READ_TDI.cmm (0x011AED48)
 PRINTF "A_PMU_WLAN_PHY_TXRFIF_RXB_CLK_CFG_RCGR    " 
do Fermion_JTAG2AHB_READ_TDI.cmm (0x011AED4C)
 PRINTF "A_PMU_WLAN_PHY_TX_RXFAST_CLK_CMD_RCGR     " 
do Fermion_JTAG2AHB_READ_TDI.cmm (0x011AED50)
 PRINTF "A_PMU_WLAN_PHY_TX_RXFAST_CLK_CFG_RCGR     " 
do Fermion_JTAG2AHB_READ_TDI.cmm (0x011AED54)
 PRINTF "A_PMU_WLAN_PHY_TXTOP_DAC_CLK_CMD_RCGR     " 
do Fermion_JTAG2AHB_READ_TDI.cmm (0x011AED58)
 PRINTF "A_PMU_WLAN_PHY_TXTOP_DAC_CLK_CFG_RCGR     " 
do Fermion_JTAG2AHB_READ_TDI.cmm (0x011AED5C)
 PRINTF "A_PMU_SLP_CLK_CMD_RCGR                    " 
do Fermion_JTAG2AHB_READ_TDI.cmm (0x011AED60)
 PRINTF "A_PMU_XO_CLK_CMD_RCGR                     " 
do Fermion_JTAG2AHB_READ_TDI.cmm (0x011AED64)
 PRINTF "A_PMU_WCSS_12M_CLK_CMD_RCGR               " 
do Fermion_JTAG2AHB_READ_TDI.cmm (0x011AED68)
 PRINTF "A_PMU_WUR_CORE_CLK_CMD_RCGR               " 
do Fermion_JTAG2AHB_READ_TDI.cmm (0x011AED6C)
 PRINTF "A_PMU_COMMON_QSPI_REF_CLK_CMD_RCGR        " 
do Fermion_JTAG2AHB_READ_TDI.cmm (0x011AED70)
 PRINTF "A_PMU_COMMON_QSPI_REF_CLK_CFG_RCGR        " 
do Fermion_JTAG2AHB_READ_TDI.cmm (0x011AED74)
 PRINTF "A_PMU_ADC_CLK_CMD_RCGR                    " 
do Fermion_JTAG2AHB_READ_TDI.cmm (0x011AED78)
 PRINTF "A_PMU_ADC_CLK_CFG_RCGR                    " 
do Fermion_JTAG2AHB_READ_TDI.cmm (0x011AED7C)
 PRINTF "A_PMU_WLAN_MAC_CORE_CLK_CMD_RCGR          " 
do Fermion_JTAG2AHB_READ_TDI.cmm (0x011AED80)
 PRINTF "A_PMU_WLAN_MAC_CORE_CLK_CFG_RCGR          " 
do Fermion_JTAG2AHB_READ_TDI.cmm (0x011AED84)
 PRINTF "A_PMU_WLAN_MAC_CORE_CLK_DIV_RCGR          " 
do Fermion_JTAG2AHB_READ_TDI.cmm (0x011AED88)
 PRINTF "A_PMU_COMMON_QSPI_REF_CLK_DIV_RCGR        " 
do Fermion_JTAG2AHB_READ_TDI.cmm (0x011AED8C)
 PRINTF "A_PMU_AON_XO_CLK_DIV_BY_4_CMD_RCGR        " 
do Fermion_JTAG2AHB_READ_TDI.cmm (0x011AED90)
 PRINTF "A_PMU_BBPLL_STATUS                        " 
do Fermion_JTAG2AHB_READ_TDI.cmm (0x011AEDB8)
 PRINTF "A_PMU_CFG_XO_PLL_CLK_SEL_CNTL             " 
do Fermion_JTAG2AHB_READ_TDI.cmm (0x011AEDBC)
 PRINTF "A_PMU_HW_VERSION                          " 
do Fermion_JTAG2AHB_READ_TDI.cmm (0x011AF400)
 PRINTF "A_PMU_CFG                                 " 
do Fermion_JTAG2AHB_READ_TDI.cmm (0x011AF404)
 PRINTF "A_PMU_OVRD_EN                             " 
do Fermion_JTAG2AHB_READ_TDI.cmm (0x011AF408)
 PRINTF "A_PMU_OVRD_VAL                            " 
do Fermion_JTAG2AHB_READ_TDI.cmm (0x011AF40C)
 PRINTF "A_PMU_WMAC_CSR                            " 
do Fermion_JTAG2AHB_READ_TDI.cmm (0x011AF410)
 PRINTF "A_PMU_COMMON_CSR                          " 
do Fermion_JTAG2AHB_READ_TDI.cmm (0x011AF414)
 PRINTF "A_PMU_ROOT_CLK_ENABLE                     " 
do Fermion_JTAG2AHB_READ_TDI.cmm (0x011AF418)
 PRINTF "A_PMU_CLKGATE_DISABLE                     " 
do Fermion_JTAG2AHB_READ_TDI.cmm (0x011AF41C)
 PRINTF "A_PMU_SOFT_RESET                          " 
do Fermion_JTAG2AHB_READ_TDI.cmm (0x011AF420)
 PRINTF "A_PMU_PMU_TESTBUS_CTL                     " 
do Fermion_JTAG2AHB_READ_TDI.cmm (0x011AF424)
 PRINTF "A_PMU_PMU_TESTBUS_STS                     " 
do Fermion_JTAG2AHB_READ_TDI.cmm (0x011AF428)
 PRINTF "A_PMU_TESTBUS_CTL                         " 
do Fermion_JTAG2AHB_READ_TDI.cmm (0x011AF42C)
 PRINTF "A_PMU_TESTBUS_STS                         " 
do Fermion_JTAG2AHB_READ_TDI.cmm (0x011AF430)
 PRINTF "A_PMU_WLAN_POWER_MEASURE                  " 
do Fermion_JTAG2AHB_READ_TDI.cmm (0x011AF434)
 PRINTF "A_PMU_CFG_XIP_PWR_DOWN_EARLY_WARN_TO_OK_TO" 
do Fermion_JTAG2AHB_READ_TDI.cmm  (0x011AF438)
 PRINTF "A_PMU_SPARE_IN                            " 
do Fermion_JTAG2AHB_READ_TDI.cmm (0x011AF43C)
 PRINTF "A_PMU_SPARE_OUT                           " 
do Fermion_JTAG2AHB_READ_TDI.cmm (0x011AF440)
 PRINTF "A_PMU_SLP_CNTL                            " 
do Fermion_JTAG2AHB_READ_TDI.cmm (0x011AF444)
 PRINTF "A_PMU_TOP_IO_TESTBUS_CNTL                 " 
do Fermion_JTAG2AHB_READ_TDI.cmm (0x011AF448)
 PRINTF "A_PMU_CFG_TEMP_MON_TH                     " 
do Fermion_JTAG2AHB_READ_TDI.cmm (0x011AF44C)
 PRINTF "A_PMU_CFG_VABT_MON_TH                     " 
do Fermion_JTAG2AHB_READ_TDI.cmm (0x011AF450)
 PRINTF "A_PMU_CFG_VABT_TEMP_MON_INT_EN            " 
do Fermion_JTAG2AHB_READ_TDI.cmm (0x011AF454)
 PRINTF "A_PMU_CFG_VABT_TEMP_MON_INT_CLR           " 
do Fermion_JTAG2AHB_READ_TDI.cmm (0x011AF458)
 PRINTF "A_PMU_TEMP_SNR_RD_DATA                    " 
do Fermion_JTAG2AHB_READ_TDI.cmm (0x011AF45C)
 PRINTF "A_PMU_VBAT_MON_RD_DATA                    " 
do Fermion_JTAG2AHB_READ_TDI.cmm (0x011AF460)
 PRINTF "A_PMU_CFG_ACAL_VBAT_MON_EN                " 
do Fermion_JTAG2AHB_READ_TDI.cmm (0x011AF464)
 PRINTF "A_PMU_CFG_TEMP_MON_INTERVAL               " 
do Fermion_JTAG2AHB_READ_TDI.cmm (0x011AF468)
 PRINTF "A_PMU_PMU_DBG_CNTL                        " 
do Fermion_JTAG2AHB_READ_TDI.cmm (0x011AF46C)
 PRINTF "A_PMU_PMU_DBG_MEM_START_ADDR_SIZE         " 
do Fermion_JTAG2AHB_READ_TDI.cmm (0x011AF470)
 PRINTF "A_PMU_WDOG_CTL                            " 
do Fermion_JTAG2AHB_READ_TDI.cmm (0x011AF474)
 PRINTF "A_PMU_WDOG_STS                            " 
do Fermion_JTAG2AHB_READ_TDI.cmm (0x011AF478)
 PRINTF "A_PMU_WDOG_COUNT                          " 
do Fermion_JTAG2AHB_READ_TDI.cmm (0x011AF47C)
 PRINTF "A_PMU_WDOG_BITE_SECURE                    " 
do Fermion_JTAG2AHB_READ_TDI.cmm (0x011AF480)
 PRINTF "A_PMU_WDOG_BARK_TIME                      " 
do Fermion_JTAG2AHB_READ_TDI.cmm (0x011AF484)
 PRINTF "A_PMU_WDOG_BITE_TIME                      " 
do Fermion_JTAG2AHB_READ_TDI.cmm (0x011AF488)
 PRINTF "A_PMU_WDOG_TEST                           " 
do Fermion_JTAG2AHB_READ_TDI.cmm (0x011AF48C)
 PRINTF "A_PMU_AON_SLP_TIMER_INT_CLR               " 
do Fermion_JTAG2AHB_READ_TDI.cmm (0x011AF490)
 PRINTF "A_PMU_AON_SLP_TIMER_INT_STS               " 
do Fermion_JTAG2AHB_READ_TDI.cmm (0x011AF494)
 PRINTF "A_PMU_CFG_SIF_POR_PULSE_WIDTH             " 
do Fermion_JTAG2AHB_READ_TDI.cmm (0x011AF498)
 PRINTF "A_PMU_RRAM_OTP_READ_ERR_INTR_CNTL         " 
do Fermion_JTAG2AHB_READ_TDI.cmm (0x011AF49C)
 PRINTF "A_PMU_POWER_DOMAIN_STATUS                 " 
do Fermion_JTAG2AHB_READ_TDI.cmm (0x011AF4A0)
 PRINTF "A_PMU_CFG_G2P_PREADY_TIMOUT_INTR_CNTL     " 
do Fermion_JTAG2AHB_READ_TDI.cmm (0x011AF4A4)
 PRINTF "A_PMU_G2P_PREADY_TIMOUT_TRANS_INFO        " 
do Fermion_JTAG2AHB_READ_TDI.cmm (0x011AF4A8)
 PRINTF "A_PMU_CCPU_TESTBUS_CTL                    " 
do Fermion_JTAG2AHB_READ_TDI.cmm (0x011AF4AC)
 PRINTF "A_PMU_CCPU_CTL                            " 
do Fermion_JTAG2AHB_READ_TDI.cmm (0x011AF500)
 PRINTF "A_PMU_CMEM_ACCESS_CTL                     " 
do Fermion_JTAG2AHB_READ_TDI.cmm (0x011AF504)
 PRINTF "A_PMU_CFG_XIP_PWR_UP_REQ_CLR              " 
do Fermion_JTAG2AHB_READ_TDI.cmm (0x011AF508)
 PRINTF "A_PMU_CFG_MCU_SS_STATE                    " 
do Fermion_JTAG2AHB_READ_TDI.cmm (0x011AF600)
 PRINTF "A_PMU_CFG_MCU_SYSTEM_DOWN_STATE_RESOURCE_REQ 	" 
do Fermion_JTAG2AHB_READ_TDI.cmm (0x011AF604)
 PRINTF "A_PMU_CFG_MCU_ACTIVE_STATE_RESOURCE_REQ   		" 
do Fermion_JTAG2AHB_READ_TDI.cmm (0x011AF60C)
 PRINTF "A_PMU_CFG_MCU_SLEEP_STATE_RESOURCE_REQ    		" 
do Fermion_JTAG2AHB_READ_TDI.cmm (0x011AF610)
 PRINTF "A_PMU_CFG_MCU_DEEPSLEEP_STATE_RESOURCE_REQ 	" 
do Fermion_JTAG2AHB_READ_TDI.cmm (0x011AF614)
 PRINTF "A_PMU_CFG_WUR_SS_STATE                    		" 
do Fermion_JTAG2AHB_READ_TDI.cmm (0x011AF628)
 PRINTF "A_PMU_CFG_WUR_OFF_STATE_RESOURCE_REQ      		" 
do Fermion_JTAG2AHB_READ_TDI.cmm (0x011AF62C)
 PRINTF "A_PMU_CFG_WUR_ON_STATE_RESOURCE_REQ       		" 
do Fermion_JTAG2AHB_READ_TDI.cmm (0x011AF630)
 PRINTF "A_PMU_CFG_WUR_ON_WITH_CPU_STATE_RESOURCE_REQ 	" 
do Fermion_JTAG2AHB_READ_TDI.cmm (0x011AF634)
 PRINTF "A_PMU_CFG_WUR_SLEEP_STATE_RESOURCE_REQ    		" 
do Fermion_JTAG2AHB_READ_TDI.cmm (0x011AF638)
 PRINTF "A_PMU_CFG_WIFI_SS_STATE                   		" 
do Fermion_JTAG2AHB_READ_TDI.cmm (0x011AF650)
 PRINTF "A_PMU_CFG_WIFI_OFF_STATE_RESOURCE_REQ     		" 
do Fermion_JTAG2AHB_READ_TDI.cmm (0x011AF654)
 PRINTF "A_PMU_CFG_WIFI_CONFIG_STATE_RESOURCE_REQ  		" 
do Fermion_JTAG2AHB_READ_TDI.cmm (0x011AF658)
 PRINTF "A_PMU_CFG_WIFI_TX_STATE_RESOURCE_REQ      		" 
do Fermion_JTAG2AHB_READ_TDI.cmm (0x011AF65C)
 PRINTF "A_PMU_CFG_WIFI_RXA_STATE_RESOURCE_REQ     		" 
do Fermion_JTAG2AHB_READ_TDI.cmm (0x011AF660)
 PRINTF "A_PMU_CFG_WIFI_RXB_LISTEN_STATE_RESOURCE_REQ 	" 
do Fermion_JTAG2AHB_READ_TDI.cmm (0x011AF664)
 PRINTF "A_PMU_CFG_WIFI_SLEEP_STATE_RESOURCE_REQ   		" 
do Fermion_JTAG2AHB_READ_TDI.cmm (0x011AF668)
 PRINTF "A_PMU_CFG_WIFI_DEEPSLEEP_STATE_RESOURCE_REQ 	" 
do Fermion_JTAG2AHB_READ_TDI.cmm (0x011AF66C)
 PRINTF "A_PMU_CFG_WIFI_RTT_STATE_RESOURCE_REQ     		" 
do Fermion_JTAG2AHB_READ_TDI.cmm (0x011AF670)
 PRINTF "A_PMU_CFG_CXC_WLAN_SLEEP_ANNOUNCEMENT_CNTL 	" 
do Fermion_JTAG2AHB_READ_TDI.cmm (0x011AF678)
 PRINTF "A_PMU_CFG_CXC_INT_SEQ_CNTL                " 
do Fermion_JTAG2AHB_READ_TDI.cmm (0x011AF67C)
 PRINTF "A_PMU_CFG_STATE_TRANS_COUNT0              " 
do Fermion_JTAG2AHB_READ_TDI.cmm (0x011AF680)
 PRINTF "A_PMU_CFG_STATE_TRANS_COUNT1              " 
do Fermion_JTAG2AHB_READ_TDI.cmm (0x011AF684)
 PRINTF "A_PMU_CFG_GLB_TMR_LSB                     " 
do Fermion_JTAG2AHB_READ_TDI.cmm (0x011AF688)
 PRINTF "A_PMU_CFG_GLB_TMR_MSB                     " 
do Fermion_JTAG2AHB_READ_TDI.cmm (0x011AF68C)
 PRINTF "A_PMU_CFG_PMIC_REFBIAS_TRIM_LSB           " 
do Fermion_JTAG2AHB_READ_TDI.cmm (0x011AF800)
 PRINTF "A_PMU_CFG_PMIC_REFBIAS_TRIM_MSB           " 
do Fermion_JTAG2AHB_READ_TDI.cmm (0x011AF804)
 PRINTF "A_PMU_CFG_XO_VREF                         " 
do Fermion_JTAG2AHB_READ_TDI.cmm (0x011AF808)
 PRINTF "A_PMU_CFG_XO_TUNING_LSB                   " 
do Fermion_JTAG2AHB_READ_TDI.cmm (0x011AF80C)
 PRINTF "A_PMU_CFG_XO_TUNING_MSB                   " 
do Fermion_JTAG2AHB_READ_TDI.cmm (0x011AF810)
 PRINTF "A_PMU_AON_TOP_CFG                         " 
do Fermion_JTAG2AHB_READ_TDI.cmm (0x011AF818)
 PRINTF "A_PMU_DIG_TOP_CFG                         " 
do Fermion_JTAG2AHB_READ_TDI.cmm (0x011AF81C)
 PRINTF "A_PMU_CFG_HW_DTIM_MODE                    " 
do Fermion_JTAG2AHB_READ_TDI.cmm (0x011AF820)
 PRINTF "A_PMU_SYSTEM_STATUS                       " 
do Fermion_JTAG2AHB_READ_TDI.cmm (0x011AF824)
 PRINTF "A_PMU_SON_GDSCR                           " 
do Fermion_JTAG2AHB_READ_TDI.cmm (0x011AF828)
 PRINTF "A_PMU_XO_GDSCR                            " 
do Fermion_JTAG2AHB_READ_TDI.cmm (0x011AF82C)
 PRINTF "A_PMU_RFA_DTOP_GDSCR                      " 
do Fermion_JTAG2AHB_READ_TDI.cmm (0x011AF830)
 PRINTF "A_PMU_PMIC_DTOP_GDSCR                     " 
do Fermion_JTAG2AHB_READ_TDI.cmm (0x011AF834)
 PRINTF "A_PMU_SON_BCR                             " 
do Fermion_JTAG2AHB_READ_TDI.cmm (0x011AF83C)
 PRINTF "A_PMU_XO_BCR                              " 
do Fermion_JTAG2AHB_READ_TDI.cmm (0x011AF840)
 PRINTF "A_PMU_RFA_DTOP_BCR                        " 
do Fermion_JTAG2AHB_READ_TDI.cmm (0x011AF844)
 PRINTF "A_PMU_PMIC_DTOP_BCR                       " 
do Fermion_JTAG2AHB_READ_TDI.cmm (0x011AF848)
 PRINTF "A_PMU_CFG_AON_SM_DELAYS                   " 
do Fermion_JTAG2AHB_READ_TDI.cmm (0x011AF84C)
 PRINTF "A_PMU_CFG_AON_CNTL_MCU_SYSTEM_DOWN_STATE_RESOURCE_REQ 			" 
do Fermion_JTAG2AHB_READ_TDI.cmm (0x011AF850)
 PRINTF "A_PMU_CFG_AON_CNTL_MCU_SYSTEM_BOOT_COMPLETE_STATE_RESOURCE_REQ " 
do Fermion_JTAG2AHB_READ_TDI.cmm (0x011AF854)
 PRINTF "A_PMU_CFG_AON_CNTL_MCU_ACTIVE_STATE_RESOURCE_REQ 				" 
do Fermion_JTAG2AHB_READ_TDI.cmm (0x011AF858)
 PRINTF "A_PMU_CFG_AON_CNTL_MCU_SLEEP_STATE_RESOURCE_REQ 				" 
do Fermion_JTAG2AHB_READ_TDI.cmm (0x011AF85C)
 PRINTF "A_PMU_CFG_AON_CNTL_MCU_DEEPSLEEP_STATE_RESOURCE_REQ 			" 
do Fermion_JTAG2AHB_READ_TDI.cmm (0x011AF860)
 PRINTF "A_PMU_CFG_AON_CNTL_WUR_OFF_STATE_RESOURCE_REQ 					" 
do Fermion_JTAG2AHB_READ_TDI.cmm (0x011AF864)
 PRINTF "A_PMU_CFG_AON_CNTL_WUR_ON_STATE_RESOURCE_REQ 					" 
do Fermion_JTAG2AHB_READ_TDI.cmm (0x011AF868)
 PRINTF "A_PMU_CFG_AON_CNTL_WUR_ON_WITH_CPU_STATE_RESOURCE_REQ 			" 
do Fermion_JTAG2AHB_READ_TDI.cmm (0x011AF86C)
 PRINTF "A_PMU_CFG_AON_CNTL_WUR_SLEEP_STATE_RESOURCE_REQ 				" 
do Fermion_JTAG2AHB_READ_TDI.cmm (0x011AF870)
 PRINTF "A_PMU_CFG_AON_CNTL_WIFI_OFF_STATE_RESOURCE_REQ 				" 
do Fermion_JTAG2AHB_READ_TDI.cmm (0x011AF874)
 PRINTF "A_PMU_CFG_AON_CNTL_WIFI_CONFIG_STATE_RESOURCE_REQ 				" 
do Fermion_JTAG2AHB_READ_TDI.cmm (0x011AF878)
 PRINTF "A_PMU_CFG_AON_CNTL_WIFI_TX_STATE_RESOURCE_REQ 					" 
do Fermion_JTAG2AHB_READ_TDI.cmm (0x011AF87C)
 PRINTF "A_PMU_CFG_AON_CNTL_WIFI_RXA_STATE_RESOURCE_REQ 				" 
do Fermion_JTAG2AHB_READ_TDI.cmm (0x011AF880)
 PRINTF "A_PMU_CFG_AON_CNTL_WIFI_RXB_LISTEN_STATE_RESOURCE_REQ 			" 
do Fermion_JTAG2AHB_READ_TDI.cmm (0x011AF884)
 PRINTF "A_PMU_CFG_AON_CNTL_WIFI_SLEEP_STATE_RESOURCE_REQ 				" 
do Fermion_JTAG2AHB_READ_TDI.cmm (0x011AF888)
 PRINTF "A_PMU_CFG_AON_CNTL_WIFI_DEEPSLEEP_STATE_RESOURCE_REQ 			" 
do Fermion_JTAG2AHB_READ_TDI.cmm (0x011AF88C)
 PRINTF "A_PMU_SLP_TMR_CTL                         " 
do Fermion_JTAG2AHB_READ_TDI.cmm (0x011AF890)
 PRINTF "A_PMU_SLP_TMR_VAL_LSB_WR                  " 
do Fermion_JTAG2AHB_READ_TDI.cmm (0x011AF894)
 PRINTF "A_PMU_SLP_TMR_VAL_MSB_WR                  " 
do Fermion_JTAG2AHB_READ_TDI.cmm (0x011AF898)
 PRINTF "A_PMU_SLP_TMR_VAL_LSB                     " 
do Fermion_JTAG2AHB_READ_TDI.cmm (0x011AF89C)
 PRINTF "A_PMU_SLP_TMR_VAL_MSB                     " 
do Fermion_JTAG2AHB_READ_TDI.cmm (0x011AF8A0)
 PRINTF "A_PMU_WLAN_SLP_TMR_CTL                    " 
do Fermion_JTAG2AHB_READ_TDI.cmm (0x011AF8A4)
 PRINTF "A_PMU_WLAN_SLP_TMR_STS                    " 
do Fermion_JTAG2AHB_READ_TDI.cmm (0x011AF8A8)
 PRINTF "A_PMU_WLAN_SLP_TMR_EXP_LSB                " 
do Fermion_JTAG2AHB_READ_TDI.cmm (0x011AF8AC)
 PRINTF "A_PMU_WLAN_SLP_TMR_EXP_MSB                " 
do Fermion_JTAG2AHB_READ_TDI.cmm (0x011AF8B0)
 PRINTF "A_PMU_WLAN_SLP_TMR_EXP_LSB_RD             " 
do Fermion_JTAG2AHB_READ_TDI.cmm (0x011AF8B4)
 PRINTF "A_PMU_WLAN_SLP_TMR_EXP_MSB_RD             " 
do Fermion_JTAG2AHB_READ_TDI.cmm (0x011AF8B8)
 PRINTF "A_PMU_AON_LIC_INT_EN                      " 
do Fermion_JTAG2AHB_READ_TDI.cmm (0x011AF8BC)
 PRINTF "A_PMU_AON_LIC_INT_CLR                     " 
do Fermion_JTAG2AHB_READ_TDI.cmm (0x011AF8C0)
 PRINTF "A_PMU_AON_LIC_INT_POL                     " 
do Fermion_JTAG2AHB_READ_TDI.cmm (0x011AF8C4)
 PRINTF "A_PMU_AON_LIC_INT_POS_EDGE_EN             " 
do Fermion_JTAG2AHB_READ_TDI.cmm (0x011AF8C8)
 PRINTF "A_PMU_AON_LIC_INT_NEG_EDGE_EN             " 
do Fermion_JTAG2AHB_READ_TDI.cmm (0x011AF8CC)
 PRINTF "A_PMU_AON_LIC_INT_ACK_EN                  " 
do Fermion_JTAG2AHB_READ_TDI.cmm (0x011AF8D0)
 PRINTF "A_PMU_AON_LIC_INT_STICKY_EN               " 
do Fermion_JTAG2AHB_READ_TDI.cmm (0x011AF8D4)
 PRINTF "A_PMU_AON_LIC_INT_STAT                    " 
do Fermion_JTAG2AHB_READ_TDI.cmm (0x011AF8D8)
 PRINTF "A_PMU_AON_TESTBUS_SEL                     " 
do Fermion_JTAG2AHB_READ_TDI.cmm (0x011AF8DC)
 PRINTF "A_PMU_AON_WDOG_CTL                        " 
do Fermion_JTAG2AHB_READ_TDI.cmm (0x011AF8E0)
 PRINTF "A_PMU_AON_WDOG_STS                        " 
do Fermion_JTAG2AHB_READ_TDI.cmm (0x011AF8E4)
 PRINTF "A_PMU_AON_WDOG_COUNT                      " 
do Fermion_JTAG2AHB_READ_TDI.cmm (0x011AF8E8)
 PRINTF "A_PMU_AON_WDOG_BITE_SECURE                " 
do Fermion_JTAG2AHB_READ_TDI.cmm (0x011AF8EC)
 PRINTF "A_PMU_AON_WDOG_BARK_TIME                  " 
do Fermion_JTAG2AHB_READ_TDI.cmm (0x011AF8F0)
 PRINTF "A_PMU_AON_WDOG_BITE_TIME                  " 
do Fermion_JTAG2AHB_READ_TDI.cmm (0x011AF8F4)
 PRINTF "A_PMU_AON_WDOG_TEST                       " 
do Fermion_JTAG2AHB_READ_TDI.cmm (0x011AF8F8)
 PRINTF "A_PMU_BOOT_STRAP_CONFIGURATION_STATUS     " 
do Fermion_JTAG2AHB_READ_TDI.cmm (0x011AF8FC)
 PRINTF "A_PMU_CFG_IO_RET_CNTL                     " 
do Fermion_JTAG2AHB_READ_TDI.cmm (0x011AF900)
 PRINTF "A_PMU_GPIO_DIR_STATUS                     " 
do Fermion_JTAG2AHB_READ_TDI.cmm (0x011AF904)
 PRINTF "A_PMU_CFG_IOPAD_DS                        " 
do Fermion_JTAG2AHB_READ_TDI.cmm (0x011AF908)
 PRINTF "A_PMU_CFG_IOPAD_PU                        " 
do Fermion_JTAG2AHB_READ_TDI.cmm (0x011AF90C)
 PRINTF "A_PMU_CFG_IOPAD_PD                        " 
do Fermion_JTAG2AHB_READ_TDI.cmm (0x011AF910)
 PRINTF "A_PMU_EXT_WAKEUP_INTR_N_RAW_STATUS        " 
do Fermion_JTAG2AHB_READ_TDI.cmm (0x011AF914)
 PRINTF "A_PMU_CFG_MEM_ACC_SB_1P                   " 
do Fermion_JTAG2AHB_READ_TDI.cmm (0x011AF918)
 PRINTF "A_PMU_CFG_MEM_ACC_MB_1P                   " 
do Fermion_JTAG2AHB_READ_TDI.cmm (0x011AF91C)
 PRINTF "A_PMU_CFG_MEM_ACC_2P                      " 
do Fermion_JTAG2AHB_READ_TDI.cmm (0x011AF920)
 PRINTF "A_PMU_BOOT_STRAP_CONFIG_SECURE            " 
do Fermion_JTAG2AHB_READ_TDI.cmm (0x011AF924)
 PRINTF "A_PMU_CFG_PMIC_SLEEP_MODE_CNTL            " 
do Fermion_JTAG2AHB_READ_TDI.cmm (0x011AF928)
 PRINTF "A_PMU_CFG_XO_SETTLE_TIME                  " 
do Fermion_JTAG2AHB_READ_TDI.cmm (0x011AF92C)
 PRINTF "A_PMU_CFG_SYS_RESET_EXTEND_TIME           " 
do Fermion_JTAG2AHB_READ_TDI.cmm (0x011AF930)
 PRINTF "A_PMU_CFG_CMEM_BANK_A_RET_EN              " 
do Fermion_JTAG2AHB_READ_TDI.cmm (0x011AF934)
 PRINTF "A_PMU_CFG_IO_BASED_STRAP_OVERRIDE_VALUE   " 
do Fermion_JTAG2AHB_READ_TDI.cmm (0x011AF938)
 PRINTF "A_PMU_IO_RAW_STRAP_VALUE                  " 
do Fermion_JTAG2AHB_READ_TDI.cmm (0x011AF93C)
 PRINTF "A_PMU_CFG_SLP_CAL_CAL_EN                  " 
do Fermion_JTAG2AHB_READ_TDI.cmm (0x011AF940)
 PRINTF "A_PMU_CFG_HBIN_0_TO_5_RANGE               " 
do Fermion_JTAG2AHB_READ_TDI.cmm (0x011AF944)
 PRINTF "A_PMU_CFG_HBIN_6_TO_11_RANGE              " 
do Fermion_JTAG2AHB_READ_TDI.cmm (0x011AF948)
 PRINTF "A_PMU_CFG_HBIN_12_TO_15_RANGE             " 
do Fermion_JTAG2AHB_READ_TDI.cmm (0x011AF94C)
 PRINTF "A_PMU_CFG_HBIN_LOW_OFFSET                 " 
do Fermion_JTAG2AHB_READ_TDI.cmm (0x011AF950)
 PRINTF "A_PMU_CFG_RS_VALUE                        " 
do Fermion_JTAG2AHB_READ_TDI.cmm (0x011AF954)
 PRINTF "A_PMU_CFG_REF_SLP_CLK_CNT                 " 
do Fermion_JTAG2AHB_READ_TDI.cmm (0x011AF958)
 PRINTF "A_PMU_CFG_HKADC_DATA_AVG_CNT              " 
do Fermion_JTAG2AHB_READ_TDI.cmm (0x011AF95C)
 PRINTF "A_PMU_CPR_CONFIG0                         " 
do Fermion_JTAG2AHB_READ_TDI.cmm (0x011AF960)
 PRINTF "A_PMU_CPR_CONFIG1                         " 
do Fermion_JTAG2AHB_READ_TDI.cmm (0x011AF964)
 PRINTF "A_PMU_CPR_STATUS0                         " 
do Fermion_JTAG2AHB_READ_TDI.cmm (0x011AF968)
 PRINTF "A_PMU_CFG_SMPS2_DVS_CNTL                  " 
do Fermion_JTAG2AHB_READ_TDI.cmm (0x011AF96C)
 PRINTF "A_PMU_CFG_PWFM_TRAGET                     " 
do Fermion_JTAG2AHB_READ_TDI.cmm (0x011AF970)
 PRINTF "A_PMU_CFG_ULPM_TRAGET                     " 
do Fermion_JTAG2AHB_READ_TDI.cmm (0x011AF974)
 PRINTF "A_PMU_CFG_ACTIVE_STATE_DVS                " 
do Fermion_JTAG2AHB_READ_TDI.cmm (0x011AF978)
 PRINTF "A_PMU_CFG_LUT_LOW_OFFSET_STEP_SIZE        " 
do Fermion_JTAG2AHB_READ_TDI.cmm (0x011AF97C)
 PRINTF "A_PMU_CFG_SLEEP_MODE_DEBUG_COUNT          " 
do Fermion_JTAG2AHB_READ_TDI.cmm (0x011AF980)
 PRINTF "A_PMU_CFG_SYS_SLEEP_DEEPSLEEP_DURATION_COUNT " 
do Fermion_JTAG2AHB_READ_TDI.cmm (0x011AF984)
 PRINTF "A_PMU_CFG_HBIN_RESET                      " 
do Fermion_JTAG2AHB_READ_TDI.cmm (0x011AF990)
 PRINTF "A_PMU_CFG_HBIN0                           " 
do Fermion_JTAG2AHB_READ_TDI.cmm (0x011AF994)
 PRINTF "A_PMU_CFG_HBIN1                           " 
do Fermion_JTAG2AHB_READ_TDI.cmm (0x011AF998)
 PRINTF "A_PMU_CFG_HBIN2                           " 
do Fermion_JTAG2AHB_READ_TDI.cmm (0x011AF99C)
 PRINTF "A_PMU_CFG_HBIN3                           " 
do Fermion_JTAG2AHB_READ_TDI.cmm (0x011AF9A0)
 PRINTF "A_PMU_CFG_HBIN4                           " 
do Fermion_JTAG2AHB_READ_TDI.cmm (0x011AF9A4)
 PRINTF "A_PMU_CFG_HBIN5                           " 
do Fermion_JTAG2AHB_READ_TDI.cmm (0x011AF9A8)
 PRINTF "A_PMU_CFG_HBIN6                           " 
do Fermion_JTAG2AHB_READ_TDI.cmm (0x011AF9AC)
 PRINTF "A_PMU_CFG_HBIN7                           " 
do Fermion_JTAG2AHB_READ_TDI.cmm (0x011AF9B0)
 PRINTF "A_PMU_CFG_HBIN8                           " 
do Fermion_JTAG2AHB_READ_TDI.cmm (0x011AF9B4)
 PRINTF "A_PMU_CFG_HBIN9                           " 
do Fermion_JTAG2AHB_READ_TDI.cmm (0x011AF9B8)
 PRINTF "A_PMU_CFG_HBIN10                          " 
do Fermion_JTAG2AHB_READ_TDI.cmm (0x011AF9BC)
 PRINTF "A_PMU_CFG_HBIN11                          " 
do Fermion_JTAG2AHB_READ_TDI.cmm (0x011AF9C0)
 PRINTF "A_PMU_CFG_HBIN12                          " 
do Fermion_JTAG2AHB_READ_TDI.cmm (0x011AF9C4)
 PRINTF "A_PMU_CFG_HBIN13                          " 
do Fermion_JTAG2AHB_READ_TDI.cmm (0x011AF9C8)
 PRINTF "A_PMU_CFG_HBIN14                          " 
do Fermion_JTAG2AHB_READ_TDI.cmm (0x011AF9CC)
 PRINTF "A_PMU_CFG_HBIN15                          " 
do Fermion_JTAG2AHB_READ_TDI.cmm (0x011AF9D0)
 PRINTF "A_PMU_CFG_LUT_PWFM_RESET                  " 
do Fermion_JTAG2AHB_READ_TDI.cmm (0x011AF9E0)
 PRINTF "A_PMU_LUT_PWFM0                           " 
do Fermion_JTAG2AHB_READ_TDI.cmm (0x011AF9E4)
 PRINTF "A_PMU_LUT_PWFM1                           " 
do Fermion_JTAG2AHB_READ_TDI.cmm (0x011AF9E8)
 PRINTF "A_PMU_LUT_PWFM2                           " 
do Fermion_JTAG2AHB_READ_TDI.cmm (0x011AF9EC)
 PRINTF "A_PMU_LUT_PWFM3                           " 
do Fermion_JTAG2AHB_READ_TDI.cmm (0x011AF9F0)
 PRINTF "A_PMU_LUT_PWFM4                           " 
do Fermion_JTAG2AHB_READ_TDI.cmm (0x011AF9F4)
 PRINTF "A_PMU_LUT_PWFM5                           " 
do Fermion_JTAG2AHB_READ_TDI.cmm (0x011AF9F8)
 PRINTF "A_PMU_LUT_PWFM6                           " 
do Fermion_JTAG2AHB_READ_TDI.cmm (0x011AF9FC)
 PRINTF "A_PMU_LUT_PWFM7                           " 
do Fermion_JTAG2AHB_READ_TDI.cmm (0x011AFA00)
 PRINTF "A_PMU_LUT_PWFM8                           " 
do Fermion_JTAG2AHB_READ_TDI.cmm (0x011AFA04)
 PRINTF "A_PMU_LUT_PWFM9                           " 
do Fermion_JTAG2AHB_READ_TDI.cmm (0x011AFA08)
 PRINTF "A_PMU_LUT_PWFM10                          " 
do Fermion_JTAG2AHB_READ_TDI.cmm (0x011AFA0C)
 PRINTF "A_PMU_LUT_PWFM11                          " 
do Fermion_JTAG2AHB_READ_TDI.cmm (0x011AFA10)
 PRINTF "A_PMU_LUT_PWFM12                          " 
do Fermion_JTAG2AHB_READ_TDI.cmm (0x011AFA14)
 PRINTF "A_PMU_LUT_PWFM13                          " 
do Fermion_JTAG2AHB_READ_TDI.cmm (0x011AFA18)
 PRINTF "A_PMU_LUT_PWFM14                          " 
do Fermion_JTAG2AHB_READ_TDI.cmm (0x011AFA1C)
 PRINTF "A_PMU_LUT_PWFM15                          " 
do Fermion_JTAG2AHB_READ_TDI.cmm (0x011AFA20)
 PRINTF "A_PMU_LUT_PWFM16                          " 
do Fermion_JTAG2AHB_READ_TDI.cmm (0x011AFA24)
 PRINTF "A_PMU_LUT_PWFM17                          " 
do Fermion_JTAG2AHB_READ_TDI.cmm (0x011AFA28)
 PRINTF "A_PMU_LUT_PWFM18                          " 
do Fermion_JTAG2AHB_READ_TDI.cmm (0x011AFA2C)
 PRINTF "A_PMU_LUT_PWFM19                          " 
do Fermion_JTAG2AHB_READ_TDI.cmm (0x011AFA30)
 PRINTF "A_PMU_LUT_PWFM20                          " 
do Fermion_JTAG2AHB_READ_TDI.cmm (0x011AFA34)
 PRINTF "A_PMU_LUT_PWFM21                          " 
do Fermion_JTAG2AHB_READ_TDI.cmm (0x011AFA38)
 PRINTF "A_PMU_LUT_PWFM22                          " 
do Fermion_JTAG2AHB_READ_TDI.cmm (0x011AFA3C)
 PRINTF "A_PMU_LUT_PWFM23                          " 
do Fermion_JTAG2AHB_READ_TDI.cmm (0x011AFA40)
 PRINTF "A_PMU_LUT_PWFM24                          " 
do Fermion_JTAG2AHB_READ_TDI.cmm (0x011AFA44)
 PRINTF "A_PMU_LUT_PWFM25                          " 
do Fermion_JTAG2AHB_READ_TDI.cmm (0x011AFA48)
 PRINTF "A_PMU_LUT_PWFM26                          " 
do Fermion_JTAG2AHB_READ_TDI.cmm (0x011AFA4C)
 PRINTF "A_PMU_LUT_PWFM27                          " 
do Fermion_JTAG2AHB_READ_TDI.cmm (0x011AFA50)
 PRINTF "A_PMU_LUT_PWFM28                          " 
do Fermion_JTAG2AHB_READ_TDI.cmm (0x011AFA54)
 PRINTF "A_PMU_LUT_PWFM29                          " 
do Fermion_JTAG2AHB_READ_TDI.cmm (0x011AFA58)
 PRINTF "A_PMU_LUT_PWFM30                          " 
do Fermion_JTAG2AHB_READ_TDI.cmm (0x011AFA5C)
 PRINTF "A_PMU_LUT_PWFM31                          " 
do Fermion_JTAG2AHB_READ_TDI.cmm (0x011AFA60)
 PRINTF "A_PMU_CFG_LUT_ULPM_RESET                  " 
do Fermion_JTAG2AHB_READ_TDI.cmm (0x011AFA80)
 PRINTF "A_PMU_LUT_ULPM0                           " 
do Fermion_JTAG2AHB_READ_TDI.cmm (0x011AFA84)
 PRINTF "A_PMU_LUT_ULPM1                           " 
do Fermion_JTAG2AHB_READ_TDI.cmm (0x011AFA88)
 PRINTF "A_PMU_LUT_ULPM2                           " 
do Fermion_JTAG2AHB_READ_TDI.cmm (0x011AFA8C)
 PRINTF "A_PMU_LUT_ULPM3                           " 
do Fermion_JTAG2AHB_READ_TDI.cmm (0x011AFA90)
 PRINTF "A_PMU_LUT_ULPM4                           " 
do Fermion_JTAG2AHB_READ_TDI.cmm (0x011AFA94)
 PRINTF "A_PMU_LUT_ULPM5                           " 
do Fermion_JTAG2AHB_READ_TDI.cmm (0x011AFA98)
 PRINTF "A_PMU_LUT_ULPM6                           " 
do Fermion_JTAG2AHB_READ_TDI.cmm (0x011AFA9C)
 PRINTF "A_PMU_LUT_ULPM7                           " 
do Fermion_JTAG2AHB_READ_TDI.cmm (0x011AFAA0)
 PRINTF "A_PMU_LUT_ULPM8                           " 
do Fermion_JTAG2AHB_READ_TDI.cmm (0x011AFAA4)
 PRINTF "A_PMU_LUT_ULPM9                           " 
do Fermion_JTAG2AHB_READ_TDI.cmm (0x011AFAA8)
 PRINTF "A_PMU_LUT_ULPM10                          " 
do Fermion_JTAG2AHB_READ_TDI.cmm (0x011AFAAC)
 PRINTF "A_PMU_LUT_ULPM11                          " 
do Fermion_JTAG2AHB_READ_TDI.cmm (0x011AFAB0)
 PRINTF "A_PMU_LUT_ULPM12                          " 
do Fermion_JTAG2AHB_READ_TDI.cmm (0x011AFAB4)
 PRINTF "A_PMU_LUT_ULPM13                          " 
do Fermion_JTAG2AHB_READ_TDI.cmm (0x011AFAB8)
 PRINTF "A_PMU_LUT_ULPM14                          " 
do Fermion_JTAG2AHB_READ_TDI.cmm (0x011AFABC)
 PRINTF "A_PMU_LUT_ULPM15                          " 
do Fermion_JTAG2AHB_READ_TDI.cmm (0x011AFAC0)
 PRINTF "A_PMU_LUT_ULPM16                          " 
do Fermion_JTAG2AHB_READ_TDI.cmm (0x011AFAC4)
 PRINTF "A_PMU_LUT_ULPM17                          " 
do Fermion_JTAG2AHB_READ_TDI.cmm (0x011AFAC8)
 PRINTF "A_PMU_LUT_ULPM18                          " 
do Fermion_JTAG2AHB_READ_TDI.cmm (0x011AFACC)
 PRINTF "A_PMU_LUT_ULPM19                          " 
do Fermion_JTAG2AHB_READ_TDI.cmm (0x011AFAD0)
 PRINTF "A_PMU_LUT_ULPM20                          " 
do Fermion_JTAG2AHB_READ_TDI.cmm (0x011AFAD4)
 PRINTF "A_PMU_LUT_ULPM21                          " 
do Fermion_JTAG2AHB_READ_TDI.cmm (0x011AFAD8)
 PRINTF "A_PMU_LUT_ULPM22                          " 
do Fermion_JTAG2AHB_READ_TDI.cmm (0x011AFADC)
 PRINTF "A_PMU_LUT_ULPM23                          " 
do Fermion_JTAG2AHB_READ_TDI.cmm (0x011AFAE0)
 PRINTF "A_PMU_LUT_ULPM24                          " 
do Fermion_JTAG2AHB_READ_TDI.cmm (0x011AFAE4)
 PRINTF "A_PMU_LUT_ULPM25                          " 
do Fermion_JTAG2AHB_READ_TDI.cmm (0x011AFAE8)
 PRINTF "A_PMU_LUT_ULPM26                          " 
do Fermion_JTAG2AHB_READ_TDI.cmm (0x011AFAEC)
 PRINTF "A_PMU_LUT_ULPM27                          " 
do Fermion_JTAG2AHB_READ_TDI.cmm (0x011AFAF0)
 PRINTF "A_PMU_LUT_ULPM28                          " 
do Fermion_JTAG2AHB_READ_TDI.cmm (0x011AFAF4)
 PRINTF "A_PMU_LUT_ULPM29                          " 
do Fermion_JTAG2AHB_READ_TDI.cmm (0x011AFAF8)
 PRINTF "A_PMU_LUT_ULPM30                          " 
do Fermion_JTAG2AHB_READ_TDI.cmm (0x011AFAFC)
 PRINTF "A_PMU_LUT_ULPM31                          " 
do Fermion_JTAG2AHB_READ_TDI.cmm (0x011AFB00)
 PRINTF "A_PMU_R_OEM_DEBUG_OVERRIDE                " 
do Fermion_JTAG2AHB_READ_TDI.cmm (0x011AFB80)
 PRINTF "A_PMU_R_ROT_MANAGEMEMT                    " 
do Fermion_JTAG2AHB_READ_TDI.cmm (0x011AFB84)
 PRINTF "A_PMU_R_M4F_DIGEST_WORD0                  " 
do Fermion_JTAG2AHB_READ_TDI.cmm (0x011AFB88)
 PRINTF "A_PMU_R_M4F_DIGEST_WORD1                  " 
do Fermion_JTAG2AHB_READ_TDI.cmm (0x011AFB8C)
 PRINTF "A_PMU_R_M4F_DIGEST_WORD2                  " 
do Fermion_JTAG2AHB_READ_TDI.cmm (0x011AFB90)
 PRINTF "A_PMU_R_M4F_DIGEST_WORD3                  " 
do Fermion_JTAG2AHB_READ_TDI.cmm (0x011AFB94)
 PRINTF "A_PMU_R_M4F_DIGEST_WORD4                  " 
do Fermion_JTAG2AHB_READ_TDI.cmm (0x011AFB98)
 PRINTF "A_PMU_R_M4F_DIGEST_WORD5                  " 
do Fermion_JTAG2AHB_READ_TDI.cmm (0x011AFB9C)
 PRINTF "A_PMU_R_M4F_DIGEST_WORD6                  " 
do Fermion_JTAG2AHB_READ_TDI.cmm (0x011AFBA0)
 PRINTF "A_PMU_R_M4F_DIGEST_WORD7                  " 
do Fermion_JTAG2AHB_READ_TDI.cmm (0x011AFBA4)
 PRINTF "A_PMU_R_M4F_DIGEST_VALID                  " 
do Fermion_JTAG2AHB_READ_TDI.cmm (0x011AFBA8)
 PRINTF "A_PMU_R_KDF_XIP_STICKY_DISABLE_PROT       " 
do Fermion_JTAG2AHB_READ_TDI.cmm (0x011AFBB0)
 PRINTF "A_PMU_R_KDF_DELEGATION_STICKY_MASK        " 
do Fermion_JTAG2AHB_READ_TDI.cmm (0x011AFBB4)
 PRINTF "A_PMU_R_MISSION_MODE_KDF_XIP_STICKY_DISABLE_PROT " 
do Fermion_JTAG2AHB_READ_TDI.cmm (0x011AFBB8)
;;;

PRINTF "Finished reading PMU registers..."
;;;;;;;;;;;;;;;;;;;;;;;;;;;;;;;;;;;;;;;;;;;;;;;;;;;;;;;;;;;;;;;;;;;;;;

area.CLOSE A000 ;; Saving the full register-read log
 
; Lock JTAG port and enable debug cable
JTAG.LOCK
JTAG.PIN ENable
; release System Reset and reset TAP Controller
JTAG.PIN NRESET HIGH
JTAG.PIN NTRST LOW
WAIT 50.MS ; wait until reset is active
JTAG.PIN NTRST HIGH
WAIT 50.MS ; wait until reset is released





; move from “Run-Test/ Idle“ to "Shift-IR" state
JTAG.SHIFTTMS 0 0 0 1 1 0 0

; 7 Bit "Shift-IR" value 0x0B, switch to "Exit1-IR" on last bit
JTAG.SHIFTREG 1 1 0 1 0 0 0

; move to “Run-Test/ Idle“ from "Exit1-IR" state
JTAG.SHIFTTMS 1 0

; release JTAG port
JTAG.PIN TMS 0 ; Pull TMS pin to 0
JTAG.PIN TDI 0 ; Pull TDI pin to 0
JTAG.UNLOCK


; Manual config
SYS.CPU CortexM4F 
SYS.Option EnReset OFF 
SYS.Option TRST OFF 
;SYS.jtagclock CTCK 100KHz 
SYS.jtagclock CTCK 1MHz
SYS.CONFIG.AHBAP1.Base DP:0x40000
SYS.MEMACCESS AHB

SYS.Attach 
Break

d.dump 0x001A0FB0--0x001A0FFF


 



