;&scripts=OS.ENV("FERMION_SCRIPTS_DIR")
;&scriptsLogs=OS.ENV("FERMION_SCRIPTS_LOG_DIR")

;cd &scripts

;area
sys.resetout
SYStem.CONFIG DAPIRPOST 4
SYStem.CONFIG DAPIRPRE 0
SYStem.CONFIG DAPDRPOST 1
SYStem.CONFIG DAPDRPRE 0

; FPGA TOP Reg
; 0     - DCM bypass (if enabled by internal DCM register
; 5:1   - clock divder 4'b0010 (div 16) No longer programable  on E1_12 onwards
; 9:6   - FPGA timing read only will always be 4'b0010 (div 16) on E1_12 onwards
; 10    - NOT legacy SPI slave connection - 0 = legacy 1 Aria U12 only
; 11    - 1 ARIA GPIO Mode 0 USB
; 13:12 - USB GPIO mux select 2'b11 = GPIO14, 2'b10 CLK_REQ , 2'b01 TSF_SYNC, 2'b00 F2A_WAKE
; 14    - SPI seleect 1- USB 0 - ARIA
; 15    - Daisy chain enable - this FPGA is master for chain
; 17:16 - QSPI ref clock select E1_17 onwards 
;         2'b00 120 MHz (SPI 30 MHz) 
;         2'b01 30  MHz (SPI 7.5 MHz) 
;         2'b10 100 MHz (SPI 25 MHz)
;         2'b11 120 MHz (SPI 30 MHz)
;;do JTAG2AHB_WRITE_only_U11.cmm 0x01EF0000 0x18445

; Set the BOOT complete to 
; [0]   power up PMIC
; [1]   power up XO_DTOP
; [2]   power up RFA_DTOP
; [3]   power up SON
; [5:4] power up MEM_NORMAL(01) RETTAINED(10) OFF (00)
; [6]   power up CSS
; [7]   Boot from CMEMA
; [8]   Boot from CMEMB
; [9]   Boot from CMEMC
; [10]  Boot from CMEMD
; [11]  Boot from RRAM
; [22]  Boot from CMEME
;;do JTAG2AHB_WRITE_combined.cmm 0x011af854 0xFFDF

; Boot code download complete
;;do JTAG2AHB_WRITE_combined.cmm 0x011af404 0x800000

; 32bit Write RRAM legacy mode
;;do JTAG2AHB_WRITE_combined.cmm 0x011af81C 0x84002080


; PBL_WRITTEN_KDF_XIP_STICKY_DISABLE_PROT
;;do JTAG2AHB_WRITE_combined.cmm 0x011afbb0 0x80000000


; Configure for new IR/DR length and steer to U12
;;SYStem.CONFIG DAPIRPOST 7
;;SYStem.CONFIG DAPIRPRE 0
;;SYStem.CONFIG DAPDRPOST 1
;;SYStem.CONFIG DAPDRPRE 0
SYStem.CONFIG SLAVE OFF
 
; Lock JTAG port and enable debug cable
;;JTAG.LOCK
;;JTAG.PIN ENable
; release System Reset and reset TAP Controller
;;JTAG.PIN NRESET HIGH
;;JTAG.PIN NTRST LOW
;;WAIT 50.MS ; wait until reset is active
;;JTAG.PIN NTRST HIGH
;;WAIT 50.MS ; wait until reset is released


; move from Run-Test/ Idle to "Shift-IR" state
;;JTAG.SHIFTTMS 0 0 0 1 1 0 0
;;JTAG.SHIFTREG 1 1 0 1 0 0 0 1 1 1 1 1 1 1

; 14 Bit "Shift-IR" value 0x0B, switch to "Exit1-IR" on last bit
; First 7 bits are for U12 second for U11
;;JTAG.SHIFTREG 1 1 0 1 0 0 0 1 1 1 1 1 1 1


; move to Run-Test/ Idle from "Exit1-IR" state
;;JTAG.SHIFTTMS 1 0

; release JTAG port
;;JTAG.PIN TMS 0 ; Pull TMS pin to 0
;;JTAG.PIN TDI 0 ; Pull TDI pin to 0
;;JTAG.UNLOCK


; Manual config
SYS.CPU CortexM4F 
SYS.Option EnReset OFF 
SYS.Option TRST OFF 
;SYS.jtagclock CTCK 100KHz 
SYS.jtagclock CTCK 1MHz
SYS.CONFIG.AHBAP1.Base DP:0x40000
SYS.MEMACCESS AHB

SYS.Attach 
Break
MAP.BOnchip 0x00200000--0x00380000

;d.dump 0x4
;Data.Set SD:0x011af854  %long %le 0xFFDF
;Data.Set SD:0x119F000 %LE %Long 0x20022728
;Data.Set SD:0x1180000 %LE %Long 0x0
;Data.Set SD:0x1180000 %LE %Long 0x1
;Data.Set SD:0x1EF0000 %LE %Long 0x100445
Data.Set SD:0x1ef0000  %LE %Long 0x4C45
;d.dump 0x1ef0000

;cd &scriptsLogs
 



