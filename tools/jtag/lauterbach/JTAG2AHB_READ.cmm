ENTRY &addr

; Pre-compute the bit string that will be sent for 64-bit TDR instruction
&shiftStr="0 1"

Repeat 0x20
(
	&shiftStr="0 &shiftStr"
)

&addr=&addr>>2

Repeat 0x1e
(
	&shiftStr=FORMAT.BINary(1,&addr&1)+" &shiftStr"
	&addr=&addr>>1
)

; Lock JTAG port and enable debug cable
JTAG.LOCK
JTAG.PIN ENable
; release System Reset and reset TAP Controller
JTAG.PIN NRESET HIGH
JTAG.PIN NTRST LOW
WAIT 50.MS ; wait until reset is active
JTAG.PIN NTRST HIGH
WAIT 50.MS ; wait until reset is released

; move from “Run-Test/ Idle“ to "Shift-IR" state
JTAG.SHIFTTMS 0 0 0 1 1 0 0

; 7 Bit "Shift-IR" value 0x0E, switch to "Exit1-IR" on last bit
JTAG.SHIFTREG 0 1 1 1 0 0 0

; move to “Run-Test/ Idle“ & then back to "Shift-DR" state
JTAG.SHIFTTMS 1 0 1 0 0

; 64 Bit "Shift-DR" instruction specifying write operation, WITH exiting to "Exit1-DR"
JTAG.SHIFTREG &shiftStr

; Now move back to "Shift-DR" state via “Run-Test/ Idle“ state with some dummy cycles in between
JTAG.SHIFTTMS 1 0 0 0 0 1 0 0

LOCAL &lowDW
LOCAL &highDW

Repeat
(
; 32 Bit "Shift-DR", WITHOUT exiting "Shift-DR"
JTAG.SHIFTTDI 0 0 0 0 0 0 0 0 0 0 0 0 0 0 0 0 0 0 0 0 0 0 0 0 0 0 0 0 0 0 0 0
; get data read out via TDO
&lowDW=JTAG.SHIFT()
; 32 Bit "Shift-DR", WITH exiting to "Exit1-DR"
JTAG.SHIFTTDI 0 0 0 0 0 0 0 0 0 0 0 0 0 0 0 0 0 0 0 0 0 0 0 0 0 0 0 0 0 0 0 0
; get data read out via TDO
&highDW=JTAG.SHIFT()
; if read completion bit not set move back to "Shift-DR" via "Update-DR", "Select-DR" and "Capture-DR"
IF ((&lowDW&0x40000000)!=0x40000000)
	JTAG.SHIFTTMS 1 1 0 0
)
While ((&lowDW&0x40000000)!=0x40000000)

; move from "Exit1-DR" to "Run-Test/ Idle" state
JTAG.SHIFTTMS 1 0
; release JTAG port
JTAG.PIN TMS 0 ; Pull TMS pin to 0
JTAG.PIN TDI 0 ; Pull TDI pin to 0
JTAG.UNLOCK
; assemble regVal
LOCAL &regVal
; &regVal=FORMAT.HEX(4,&highValHighDW)+FORMAT.HEX(4,&lowValHighDW)+FORMAT.HEX(4,&highValLowDW)+FORMAT.HEX(4,&lowValLowDW)
; &regVal=FORMAT.HEX(8,&highDW)+FORMAT.HEX(8,&lowDW)
;PRINT "Register value: "+FORMAT.HEX(8,&highDW)+FORMAT.HEX(8,&lowDW)
IF ((&highDW&0x80000000)==0)&&((&lowDW&0x40000000)==0x40000000)
(
	&regVal=&lowDW>>0x1f&1
	Repeat 0x1f
	(
		&regVal=&regVal<<1|&highDW&1
		&highDW=&highDW>>1
	)
)
ELSE
(
	&regVal=0xbaadbaad
)
PRINT "Register value: &regVal"
ENDDO &regVal

