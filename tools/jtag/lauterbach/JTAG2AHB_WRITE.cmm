ENTRY &addr &value

PRINT "JTAG2AHB_WRITE.cmm Writing &value to address &addr"
LOG.OFF

; Pre-compute the bit string that will be sent for 64-bit TDR instruction
&shiftStr="1 0"

Repeat 0x20
(
	&shiftStr=FORMAT.BINary(1,&value&1)+" &shiftStr"
	&value=&value>>1
)

&addr=&addr>>2

Repeat 0x1e
(
	&shiftStr=FORMAT.BINary(1,&addr&1)+" &shiftStr"
	&addr=&addr>>1
)

; Lock JTAG port and enable debug cable
JTAG.LOCK
JTAG.PIN ENable
; release System Reset and reset TAP Controller
JTAG.PIN NRESET HIGH
JTAG.PIN NTRST LOW
WAIT 50.MS ; wait until reset is active
JTAG.PIN NTRST HIGH
WAIT 50.MS ; wait until reset is released

; move from “Run-Test/ Idle“ to "Shift-IR" state
JTAG.SHIFTTMS 0 0 0 1 1 0 0

; 7 Bit "Shift-IR" value 0x0E, switch to "Exit1-IR" on last bit
JTAG.SHIFTREG 0 1 1 1 0 0 0

; move to “Run-Test/ Idle“ & then back to "Shift-DR" state
JTAG.SHIFTTMS 1 0 1 0 0

; 64 Bit "Shift-DR" instruction specifying write operation, WITH exiting to "Exit1-DR"
JTAG.SHIFTREG &shiftStr

; Now move back to "Shift-DR" state via “Run-Test/ Idle“ state with some dummy cycles in between
JTAG.SHIFTTMS 1 0 0 0 0 1 0 0

; 16 Bit "Shift-DR", WITHOUT exiting "Shift-DR"
JTAG.SHIFTTDI 0 0 0 0 0 0 0 0 0 0 0 0 0 0 0 0
; get data read out via TDO
&lowValLowDW=JTAG.SHIFT()
; 16 Bit "Shift-DR", WITHOUT exiting to "Exit1-DR"
JTAG.SHIFTTDI 0 0 0 0 0 0 0 0 0 0 0 0 0 0 0 0
; get data read out via TDO
&highValLowDW=JTAG.SHIFT()
; 16 Bit "Shift-DR", WITHOUT exiting "Shift-DR"
JTAG.SHIFTTDI 0 0 0 0 0 0 0 0 0 0 0 0 0 0 0 0
; get data read out via TDO
&lowValHighDW=JTAG.SHIFT()
; 16 Bit "Shift-DR", WITH exiting to "Exit1-DR"
JTAG.SHIFTREG 0 0 0 0 0 0 0 0 0 0 0 0 0 0 0 0
; get data read out via TDO
&highValHighDW=JTAG.SHIFT()

; move from "Exit1-DR" to "Run-Test/ Idle" state
JTAG.SHIFTTMS 1 0
; release JTAG port
JTAG.PIN TMS 0 ; Pull TMS pin to 0
JTAG.PIN TDI 0 ; Pull TDI pin to 0
JTAG.UNLOCK
; assemble regVal
&regVal=FORMAT.HEX(4,&highValHighDW)+FORMAT.HEX(4,&lowValHighDW)+FORMAT.HEX(4,&highValLowDW)+FORMAT.HEX(4,&lowValLowDW)
LOG.ON
PRINT "Write status : &regVal"

ENDDO

