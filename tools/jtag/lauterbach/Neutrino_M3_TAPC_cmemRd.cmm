cd C:\neutrino

; Force the boot complete
do Neutrino_JTAG2AHB_WRITE.cmm 0x011af854 0xFFDF
; Force the download complete
do Neutrino_JTAG2AHB_WRITE.cmm 0x011af404 0x800000

; Lock JTAG port and enable debug cable
JTAG.LOCK
JTAG.PIN ENable
; release System Reset and reset TAP Controller
JTAG.PIN NRESET HIGH
JTAG.PIN NTRST LOW
WAIT 50.MS ; wait until reset is active
JTAG.PIN NTRST HIGH
WAIT 50.MS ; wait until reset is released

; move from “Run-Test/ Idle“ to "Shift-IR" state
JTAG.SHIFTTMS 0 0 0 1 1 0 0

; 7 Bit "Shift-IR" value 0x0B, switch to "Exit1-IR" on last bit
JTAG.SHIFTREG 1 1 0 1 0 0 0

; move to “Run-Test/ Idle“ from "Exit1-IR" state
JTAG.SHIFTTMS 1 0

; release JTAG port
JTAG.PIN TMS 0 ; Pull TMS pin to 0
JTAG.PIN TDI 0 ; Pull TDI pin to 0
JTAG.UNLOCK

SYS.CPU CortexM4F
SYS.Option EnReset OFF
SYS.Option TRST OFF
SYS.jtagclock CTCK 16MHz
SYS.Attach
Break

// Flush the I-cache
D.S SD:0x1180000 %LE %Long 0x1
D.S SD:0x1180000 %LE %Long 0x0

// UART PLL Selection - cfg_xo_pll_sel[1] = 1, cfg_xo_pll_hw_sw_cntl[0] = 1
WAIT 50.MS
D.S SD:0x011AEDC0 %LE %Long 0x00000003

WAIT 50.MS
SYStem.RESetOut